ENTRY(_start)
MEMORY {
  PageZero : org = 0x0000000000000000, len = 0x0000000000001000
  RealBss : org = 0x1000, len = (((0x2240 + 8) + (0x1000)-1) & -(0x1000))
  RealProgram : org = (0x1000 + (((0x2240 + 8) + (0x1000)-1) & -(0x1000))), len = 0x0000000000010000 - (0x1000 + (((0x2240 + 8) + (0x1000)-1) & -(0x1000)))
  RealScratch : org = 0x40000, len = 0x70000 - 0x40000
  RealStack : org = 0x70000, len = 0x0000000000010000
  EbdaMemory : org = 0x0000000000080000, len = 0x0000000000020000
  VideoMemory : org = 0x00000000000a0000, len = 0x0000000000020000
  Romz : org = 0x00000000000c0000, len = 0x0000000000030000
  BiosMemory : org = 0x00000000000f0000, len = 0x0000000000010000
  SmallCode : org = 0x100000, len = 0x0000000040000000 - 0x100000
  ZipData : org = 0x0000000040000000, len = 0x0000000040000000
}
PHDRS {
  Head PT_LOAD FLAGS(5);
  Rom PT_LOAD FLAGS(5);
  Ram PT_LOAD FLAGS(6);
  stack PT_GNU_STACK FLAGS(6);
}
SECTIONS {
  .head SEGMENT_START("text-segment", 0x400000) : {
    HIDDEN(_base = .);
    KEEP(*(.head))
    . += 1;
    . = ALIGN(. != 0 ? 8 : 1);
    KEEP(*(.elf.phdrs))
    HIDDEN(.Lape.phdrs.end = .);
    . += 1;
    . = ALIGN(. != 0 ? 8 : 1);
    HIDDEN(.Lape.note = .);
    KEEP(*(.note.openbsd.ident))
    HIDDEN(.Lape.note.end = .);
    . += 1;
    KEEP(*(.pe.header))
    HIDDEN(.Lape.pe.sections = .);
    KEEP(*(.pe.sections))
    HIDDEN(.Lape.pe.sections_end = .);
    . += 1;
    KEEP(*(.macho))
    . = ALIGN(8);
    HIDDEN(.Lape.macho.end = .);
    . += 1;
    KEEP(*(.ape.pad.head))
    . = ALIGN(4096);
    HIDDEN(_ehead = .);
  } AT>SmallCode :Head
  .text . : {
    *(.text.real)
    KEEP(*(SORT_BY_NAME(.sort.text.real.*)))
    *(.rodata.real)
    KEEP(*(SORT_BY_NAME(.sort.rodata.real.*)))
    HIDDEN(_ereal = .);
    *(.start)
    KEEP(*(.initprologue))
    KEEP(*(SORT_BY_NAME(.init.*)))
    KEEP(*(SORT_NONE(.init)))
    KEEP(*(.initepilogue))
    KEEP(*(.pltprologue))
    *(.plt)
    KEEP(*(.pltepilogue))
    KEEP(*(.pltgotprologue))
    *(.plt.got)
    KEEP(*(.pltgotepilogue))
    *(.text.startup .text.startup.*)
    *(.text.exit .text.exit.*)
    *(.text.unlikely .text.*_unlikely .text.unlikely.*)
    *(SORT_BY_ALIGNMENT(.text.antiquity))
    *(SORT_BY_ALIGNMENT(.text.antiquity.*))
    KEEP(*(.textwindowsprologue))
    *(.text.windows)
    KEEP(*(.textwindowsepilogue))
    *(SORT_BY_ALIGNMENT(.text.modernity))
    *(SORT_BY_ALIGNMENT(.text.modernity.*))
    *(SORT_BY_ALIGNMENT(.text.hot))
    *(SORT_BY_ALIGNMENT(.text.hot.*))
    KEEP(*(.keep.text))
    *(.text .stub .text.*)
    KEEP(*(SORT_BY_NAME(.sort.text.*)))
    HIDDEN(.Lape.piro.align = ABSOLUTE(. > 0x10000 ? 0x1000 : 8));
    KEEP(*(.ape.pad.test));
    . = ALIGN(.Lape.piro.align);
    HIDDEN(__test_start = .);
    *(.test.unlikely)
    *(.test .test.*)
    KEEP(*(.ape.pad.privileged));
    . = ALIGN(.Lape.piro.align);
    HIDDEN(__privileged_start = .);
    HIDDEN(__test_end = .);
    . += 1;
    *(.privileged)
    KEEP(*(.ape.pad.rodata));
    . = ALIGN(.Lape.piro.align);
    . += 1;
    *(.rodata .rodata.*)
    . += 1;
    HIDDEN(__ubsan_types_start = .);
    *(.ubsan.types)
    HIDDEN(__ubsan_types_end = .);
    . += 1;
    HIDDEN(__ubsan_data_start = .);
    *(.ubsan.data)
    HIDDEN(__ubsan_data_end = .);
    KEEP(*(.commentprologue))
    KEEP(*(.comment))
    KEEP(*(.commentepilogue))
    KEEP(*(.idata.ro));
    KEEP(*(SORT_BY_NAME(.idata.ro.*)))
    . += 1;
    KEEP(*(.initroprologue))
    KEEP(*(SORT_BY_NAME(.initro.*)))
    KEEP(*(.initroepilogue))
    KEEP(*(SORT_BY_NAME(.sort.rodata.*)))
    KEEP(*(.ape.pad.text))
    HIDDEN(.Lape.data.align = ABSOLUTE(0x1000));
    . = ALIGN(.Lape.data.align);
    HIDDEN(_etext = .);
    PROVIDE_HIDDEN(etext = .);
  } AT>SmallCode :Rom
  .data . : {
    KEEP(*(.dataprologue))
    *(.data .data.*)
    KEEP(*(SORT_BY_NAME(.sort.data.*)))
    . += . > 0 ? 1 : 0;
    KEEP(*(.gotprologue))
    *(.got)
    KEEP(*(.gotepilogue))
    KEEP(*(.gotpltprologue))
    *(.got.plt)
    KEEP(*(.gotpltepilogue))
    . = ALIGN(.Lape.piro.align);
    HIDDEN(__piro_start = .);
    QUAD(0x400000);
    PROVIDE_HIDDEN(__init_array_start = .);
    KEEP(*(SORT_BY_INIT_PRIORITY(.init_array.*)
           SORT_BY_INIT_PRIORITY(.ctors.*)))
    KEEP(*(SORT_NONE(.ctors)))
    KEEP(*(SORT_NONE(.init_array)))
    KEEP(*(SORT_NONE(.preinit_array)))
    PROVIDE_HIDDEN(__init_array_end = .);
    . += 1;
    . = ALIGN(8);
    PROVIDE_HIDDEN(__fini_array_start = .);
    KEEP(*(SORT_BY_INIT_PRIORITY(.fini_array.*)
           SORT_BY_INIT_PRIORITY(.dtors.*)))
    KEEP(*(SORT_NONE(.dtors)))
    PROVIDE_HIDDEN(__fini_array_end = .);
    KEEP(*(SORT_BY_NAME(.piro.relo.sort.*)))
    PROVIDE_HIDDEN(__relo_end = .);
    KEEP(*(SORT_BY_NAME(.piro.data.sort.*)))
    KEEP(*(.piro.pad.data))
    . = ALIGN(.Lape.data.align);
    HIDDEN(_edata = .);
    PROVIDE_HIDDEN(edata = .);
  } AT>SmallCode :Ram
  .bss . : {
    KEEP(*(SORT_BY_NAME(.piro.bss.init.*)))
    *(.piro.bss)
    KEEP(*(SORT_BY_NAME(.piro.bss.sort.*)))
    . += 1;
    . = ALIGN(.Lape.piro.align);
    HIDDEN(__piro_end = .);
    *(SORT_BY_ALIGNMENT(.bss))
    *(SORT_BY_ALIGNMENT(.bss.*))
    *(COMMON)
    KEEP(*(SORT_BY_NAME(.sort.bss.*)))
    . = ALIGN(0x1000);
    *(.xlm)
    . = ALIGN(0x1000);
    HIDDEN(_end = .);
    PROVIDE_HIDDEN(end = .);
  } AT>SmallCode :Ram
  .stab 0 : { *(.stab) }
  .stabstr 0 : { *(.stabstr) }
  .stab.excl 0 : { *(.stab.excl) }
  .stab.exclstr 0 : { *(.stab.exclstr) }
  .stab.index 0 : { *(.stab.index) }
  .stab.indexstr 0 : { *(.stab.indexstr) }
  .comment 0 : { *(.comment) }
  .debug 0 : { *(.debug) }
  .line 0 : { *(.line) }
  .debug_srcinfo 0 : { *(.debug_srcinfo) }
  .debug_sfnames 0 : { *(.debug_sfnames) }
  .debug_aranges 0 : { *(.debug_aranges) }
  .debug_pubnames 0 : { *(.debug_pubnames) }
  .debug_info 0 : { *(.debug_info .gnu.linkonce.wi.*) }
  .debug_abbrev 0 : { *(.debug_abbrev) }
  .debug_line 0 : { *(.debug_line .debug_line.* .debug_line_end ) }
  .debug_frame 0 : { *(.debug_frame) }
  .debug_str 0 : { *(.debug_str) }
  .debug_loc 0 : { *(.debug_loc) }
  .debug_macinfo 0 : { *(.debug_macinfo) }
  .debug_weaknames 0 : { *(.debug_weaknames) }
  .debug_funcnames 0 : { *(.debug_funcnames) }
  .debug_typenames 0 : { *(.debug_typenames) }
  .debug_varnames 0 : { *(.debug_varnames) }
  .debug_pubtypes 0 : { *(.debug_pubtypes) }
  .debug_ranges 0 : { *(.debug_ranges) }
  .debug_macro 0 : { *(.debug_macro) }
  .debug_addr 0 : { *(.debug_addr) }
  .gnu.attributes 0 : { KEEP(*(.gnu.attributes)) }
  .GCC.command.line 0 : { *(.GCC.command.line) }
  /DISCARD/ : {
    *(.discard)
    *(.yoink)
    *(.*)
  }
}
HIDDEN(.Lape.elf.entry = (_start)); HIDDEN(.Lape.elf.entry_bcs0 = (((((((_start) >> ((0)*8)) >> 0)&0x7) + 0x30) << 24) | ((((((_start) >> ((0)*8)) >> 3)&0x7) + 0x30) << 16) | (((((((_start) >> ((0)*8))&0xff) >> 6)&0x7) + 0x30) << 8) | 0x5c)); HIDDEN(.Lape.elf.entry_bcs1 = (((((((_start) >> ((1)*8)) >> 0)&0x7) + 0x30) << 24) | ((((((_start) >> ((1)*8)) >> 3)&0x7) + 0x30) << 16) | (((((((_start) >> ((1)*8))&0xff) >> 6)&0x7) + 0x30) << 8) | 0x5c)); HIDDEN(.Lape.elf.entry_bcs2 = (((((((_start) >> ((2)*8)) >> 0)&0x7) + 0x30) << 24) | ((((((_start) >> ((2)*8)) >> 3)&0x7) + 0x30) << 16) | (((((((_start) >> ((2)*8))&0xff) >> 6)&0x7) + 0x30) << 8) | 0x5c)); HIDDEN(.Lape.elf.entry_bcs3 = (((((((_start) >> ((3)*8)) >> 0)&0x7) + 0x30) << 24) | ((((((_start) >> ((3)*8)) >> 3)&0x7) + 0x30) << 16) | (((((((_start) >> ((3)*8))&0xff) >> 6)&0x7) + 0x30) << 8) | 0x5c)); HIDDEN(.Lape.elf.entry_bcs4 = (((((((_start) >> ((4)*8)) >> 0)&0x7) + 0x30) << 24) | ((((((_start) >> ((4)*8)) >> 3)&0x7) + 0x30) << 16) | (((((((_start) >> ((4)*8))&0xff) >> 6)&0x7) + 0x30) << 8) | 0x5c)); HIDDEN(.Lape.elf.entry_bcs5 = (((((((_start) >> ((5)*8)) >> 0)&0x7) + 0x30) << 24) | ((((((_start) >> ((5)*8)) >> 3)&0x7) + 0x30) << 16) | (((((((_start) >> ((5)*8))&0xff) >> 6)&0x7) + 0x30) << 8) | 0x5c)); HIDDEN(.Lape.elf.entry_bcs6 = (((((((_start) >> ((6)*8)) >> 0)&0x7) + 0x30) << 24) | ((((((_start) >> ((6)*8)) >> 3)&0x7) + 0x30) << 16) | (((((((_start) >> ((6)*8))&0xff) >> 6)&0x7) + 0x30) << 8) | 0x5c)); HIDDEN(.Lape.elf.entry_bcs7 = (((((((_start) >> ((7)*8)) >> 0)&0x7) + 0x30) << 24) | ((((((_start) >> ((7)*8)) >> 3)&0x7) + 0x30) << 16) | (((((((_start) >> ((7)*8))&0xff) >> 6)&0x7) + 0x30) << 8) | 0x5c));
HIDDEN(.Lape.elf.phoff = (((ape.phdrs) - (0x400000)))); HIDDEN(.Lape.elf.phoff_bcs0 = (((((((((ape.phdrs) - (0x400000))) >> ((0)*8)) >> 0)&0x7) + 0x30) << 24) | ((((((((ape.phdrs) - (0x400000))) >> ((0)*8)) >> 3)&0x7) + 0x30) << 16) | (((((((((ape.phdrs) - (0x400000))) >> ((0)*8))&0xff) >> 6)&0x7) + 0x30) << 8) | 0x5c)); HIDDEN(.Lape.elf.phoff_bcs1 = (((((((((ape.phdrs) - (0x400000))) >> ((1)*8)) >> 0)&0x7) + 0x30) << 24) | ((((((((ape.phdrs) - (0x400000))) >> ((1)*8)) >> 3)&0x7) + 0x30) << 16) | (((((((((ape.phdrs) - (0x400000))) >> ((1)*8))&0xff) >> 6)&0x7) + 0x30) << 8) | 0x5c)); HIDDEN(.Lape.elf.phoff_bcs2 = (((((((((ape.phdrs) - (0x400000))) >> ((2)*8)) >> 0)&0x7) + 0x30) << 24) | ((((((((ape.phdrs) - (0x400000))) >> ((2)*8)) >> 3)&0x7) + 0x30) << 16) | (((((((((ape.phdrs) - (0x400000))) >> ((2)*8))&0xff) >> 6)&0x7) + 0x30) << 8) | 0x5c)); HIDDEN(.Lape.elf.phoff_bcs3 = (((((((((ape.phdrs) - (0x400000))) >> ((3)*8)) >> 0)&0x7) + 0x30) << 24) | ((((((((ape.phdrs) - (0x400000))) >> ((3)*8)) >> 3)&0x7) + 0x30) << 16) | (((((((((ape.phdrs) - (0x400000))) >> ((3)*8))&0xff) >> 6)&0x7) + 0x30) << 8) | 0x5c)); HIDDEN(.Lape.elf.phoff_bcs4 = (((((((((ape.phdrs) - (0x400000))) >> ((4)*8)) >> 0)&0x7) + 0x30) << 24) | ((((((((ape.phdrs) - (0x400000))) >> ((4)*8)) >> 3)&0x7) + 0x30) << 16) | (((((((((ape.phdrs) - (0x400000))) >> ((4)*8))&0xff) >> 6)&0x7) + 0x30) << 8) | 0x5c)); HIDDEN(.Lape.elf.phoff_bcs5 = (((((((((ape.phdrs) - (0x400000))) >> ((5)*8)) >> 0)&0x7) + 0x30) << 24) | ((((((((ape.phdrs) - (0x400000))) >> ((5)*8)) >> 3)&0x7) + 0x30) << 16) | (((((((((ape.phdrs) - (0x400000))) >> ((5)*8))&0xff) >> 6)&0x7) + 0x30) << 8) | 0x5c)); HIDDEN(.Lape.elf.phoff_bcs6 = (((((((((ape.phdrs) - (0x400000))) >> ((6)*8)) >> 0)&0x7) + 0x30) << 24) | ((((((((ape.phdrs) - (0x400000))) >> ((6)*8)) >> 3)&0x7) + 0x30) << 16) | (((((((((ape.phdrs) - (0x400000))) >> ((6)*8))&0xff) >> 6)&0x7) + 0x30) << 8) | 0x5c)); HIDDEN(.Lape.elf.phoff_bcs7 = (((((((((ape.phdrs) - (0x400000))) >> ((7)*8)) >> 0)&0x7) + 0x30) << 24) | ((((((((ape.phdrs) - (0x400000))) >> ((7)*8)) >> 3)&0x7) + 0x30) << 16) | (((((((((ape.phdrs) - (0x400000))) >> ((7)*8))&0xff) >> 6)&0x7) + 0x30) << 8) | 0x5c));
HIDDEN(.Lape.elf.shoff = (0)); HIDDEN(.Lape.elf.shoff_bcs0 = (((((((0) >> ((0)*8)) >> 0)&0x7) + 0x30) << 24) | ((((((0) >> ((0)*8)) >> 3)&0x7) + 0x30) << 16) | (((((((0) >> ((0)*8))&0xff) >> 6)&0x7) + 0x30) << 8) | 0x5c)); HIDDEN(.Lape.elf.shoff_bcs1 = (((((((0) >> ((1)*8)) >> 0)&0x7) + 0x30) << 24) | ((((((0) >> ((1)*8)) >> 3)&0x7) + 0x30) << 16) | (((((((0) >> ((1)*8))&0xff) >> 6)&0x7) + 0x30) << 8) | 0x5c)); HIDDEN(.Lape.elf.shoff_bcs2 = (((((((0) >> ((2)*8)) >> 0)&0x7) + 0x30) << 24) | ((((((0) >> ((2)*8)) >> 3)&0x7) + 0x30) << 16) | (((((((0) >> ((2)*8))&0xff) >> 6)&0x7) + 0x30) << 8) | 0x5c)); HIDDEN(.Lape.elf.shoff_bcs3 = (((((((0) >> ((3)*8)) >> 0)&0x7) + 0x30) << 24) | ((((((0) >> ((3)*8)) >> 3)&0x7) + 0x30) << 16) | (((((((0) >> ((3)*8))&0xff) >> 6)&0x7) + 0x30) << 8) | 0x5c)); HIDDEN(.Lape.elf.shoff_bcs4 = (((((((0) >> ((4)*8)) >> 0)&0x7) + 0x30) << 24) | ((((((0) >> ((4)*8)) >> 3)&0x7) + 0x30) << 16) | (((((((0) >> ((4)*8))&0xff) >> 6)&0x7) + 0x30) << 8) | 0x5c)); HIDDEN(.Lape.elf.shoff_bcs5 = (((((((0) >> ((5)*8)) >> 0)&0x7) + 0x30) << 24) | ((((((0) >> ((5)*8)) >> 3)&0x7) + 0x30) << 16) | (((((((0) >> ((5)*8))&0xff) >> 6)&0x7) + 0x30) << 8) | 0x5c)); HIDDEN(.Lape.elf.shoff_bcs6 = (((((((0) >> ((6)*8)) >> 0)&0x7) + 0x30) << 24) | ((((((0) >> ((6)*8)) >> 3)&0x7) + 0x30) << 16) | (((((((0) >> ((6)*8))&0xff) >> 6)&0x7) + 0x30) << 8) | 0x5c)); HIDDEN(.Lape.elf.shoff_bcs7 = (((((((0) >> ((7)*8)) >> 0)&0x7) + 0x30) << 24) | ((((((0) >> ((7)*8)) >> 3)&0x7) + 0x30) << 16) | (((((((0) >> ((7)*8))&0xff) >> 6)&0x7) + 0x30) << 8) | 0x5c));
HIDDEN(.Lape.elf.phnum = ((.Lape.phdrs.end - ape.phdrs) / 56)); HIDDEN(.Lape.elf.phnum_bcs0 = ((((((((.Lape.phdrs.end - ape.phdrs) / 56) >> ((0)*8)) >> 0)&0x7) + 0x30) << 24) | (((((((.Lape.phdrs.end - ape.phdrs) / 56) >> ((0)*8)) >> 3)&0x7) + 0x30) << 16) | ((((((((.Lape.phdrs.end - ape.phdrs) / 56) >> ((0)*8))&0xff) >> 6)&0x7) + 0x30) << 8) | 0x5c)); HIDDEN(.Lape.elf.phnum_bcs1 = ((((((((.Lape.phdrs.end - ape.phdrs) / 56) >> ((1)*8)) >> 0)&0x7) + 0x30) << 24) | (((((((.Lape.phdrs.end - ape.phdrs) / 56) >> ((1)*8)) >> 3)&0x7) + 0x30) << 16) | ((((((((.Lape.phdrs.end - ape.phdrs) / 56) >> ((1)*8))&0xff) >> 6)&0x7) + 0x30) << 8) | 0x5c)); HIDDEN(.Lape.elf.phnum_bcs2 = ((((((((.Lape.phdrs.end - ape.phdrs) / 56) >> ((2)*8)) >> 0)&0x7) + 0x30) << 24) | (((((((.Lape.phdrs.end - ape.phdrs) / 56) >> ((2)*8)) >> 3)&0x7) + 0x30) << 16) | ((((((((.Lape.phdrs.end - ape.phdrs) / 56) >> ((2)*8))&0xff) >> 6)&0x7) + 0x30) << 8) | 0x5c)); HIDDEN(.Lape.elf.phnum_bcs3 = ((((((((.Lape.phdrs.end - ape.phdrs) / 56) >> ((3)*8)) >> 0)&0x7) + 0x30) << 24) | (((((((.Lape.phdrs.end - ape.phdrs) / 56) >> ((3)*8)) >> 3)&0x7) + 0x30) << 16) | ((((((((.Lape.phdrs.end - ape.phdrs) / 56) >> ((3)*8))&0xff) >> 6)&0x7) + 0x30) << 8) | 0x5c));
HIDDEN(.Lape.elf.shnum = (0)); HIDDEN(.Lape.elf.shnum_bcs0 = (((((((0) >> ((0)*8)) >> 0)&0x7) + 0x30) << 24) | ((((((0) >> ((0)*8)) >> 3)&0x7) + 0x30) << 16) | (((((((0) >> ((0)*8))&0xff) >> 6)&0x7) + 0x30) << 8) | 0x5c)); HIDDEN(.Lape.elf.shnum_bcs1 = (((((((0) >> ((1)*8)) >> 0)&0x7) + 0x30) << 24) | ((((((0) >> ((1)*8)) >> 3)&0x7) + 0x30) << 16) | (((((((0) >> ((1)*8))&0xff) >> 6)&0x7) + 0x30) << 8) | 0x5c)); HIDDEN(.Lape.elf.shnum_bcs2 = (((((((0) >> ((2)*8)) >> 0)&0x7) + 0x30) << 24) | ((((((0) >> ((2)*8)) >> 3)&0x7) + 0x30) << 16) | (((((((0) >> ((2)*8))&0xff) >> 6)&0x7) + 0x30) << 8) | 0x5c)); HIDDEN(.Lape.elf.shnum_bcs3 = (((((((0) >> ((3)*8)) >> 0)&0x7) + 0x30) << 24) | ((((((0) >> ((3)*8)) >> 3)&0x7) + 0x30) << 16) | (((((((0) >> ((3)*8))&0xff) >> 6)&0x7) + 0x30) << 8) | 0x5c));
HIDDEN(.Lape.elf.shstrndx = (0)); HIDDEN(.Lape.elf.shstrndx_bcs0 = (((((((0) >> ((0)*8)) >> 0)&0x7) + 0x30) << 24) | ((((((0) >> ((0)*8)) >> 3)&0x7) + 0x30) << 16) | (((((((0) >> ((0)*8))&0xff) >> 6)&0x7) + 0x30) << 8) | 0x5c)); HIDDEN(.Lape.elf.shstrndx_bcs1 = (((((((0) >> ((1)*8)) >> 0)&0x7) + 0x30) << 24) | ((((((0) >> ((1)*8)) >> 3)&0x7) + 0x30) << 16) | (((((((0) >> ((1)*8))&0xff) >> 6)&0x7) + 0x30) << 8) | 0x5c)); HIDDEN(.Lape.elf.shstrndx_bcs2 = (((((((0) >> ((2)*8)) >> 0)&0x7) + 0x30) << 24) | ((((((0) >> ((2)*8)) >> 3)&0x7) + 0x30) << 16) | (((((((0) >> ((2)*8))&0xff) >> 6)&0x7) + 0x30) << 8) | 0x5c)); HIDDEN(.Lape.elf.shstrndx_bcs3 = (((((((0) >> ((3)*8)) >> 0)&0x7) + 0x30) << 24) | ((((((0) >> ((3)*8)) >> 3)&0x7) + 0x30) << 16) | (((((((0) >> ((3)*8))&0xff) >> 6)&0x7) + 0x30) << 8) | 0x5c));
HIDDEN(.Lape.macho.dd.skip_bcs0 = ((((ape.macho) - (0x400000)) / 8) < 10000 ? 0x20202020 : (((ape.macho) - (0x400000)) / 8) < 100000 ? 0x30202020 + (((((ape.macho) - (0x400000)) / 8) / 10000 % 10) << 24) : (((ape.macho) - (0x400000)) / 8) < 1000000 ? 0x30302020 + (((((ape.macho) - (0x400000)) / 8) / 10000 % 10) << 24) + (((((ape.macho) - (0x400000)) / 8) / 100000 % 10) << 16) : (((ape.macho) - (0x400000)) / 8) < 10000000 ? 0x30303020 + (((((ape.macho) - (0x400000)) / 8) / 10000 % 10) << 24) + (((((ape.macho) - (0x400000)) / 8) / 100000 % 10) << 16) + (((((ape.macho) - (0x400000)) / 8) / 1000000 % 10) << 8) : (((ape.macho) - (0x400000)) / 8) < 100000000 ? 0x30303030 + (((((ape.macho) - (0x400000)) / 8) / 10000 % 10) << 24) + (((((ape.macho) - (0x400000)) / 8) / 100000 % 10) << 16) + (((((ape.macho) - (0x400000)) / 8) / 1000000 % 10) << 8) + (((((ape.macho) - (0x400000)) / 8) / 10000000 % 10) << 0) : 0xffffffffffffffff)); HIDDEN(.Lape.macho.dd.skip_bcs1 = ((((ape.macho) - (0x400000)) / 8) == 0 ? 0x20202030 : (((ape.macho) - (0x400000)) / 8) < 10 ? 0x30202020 + (((((ape.macho) - (0x400000)) / 8) % 10) << 24) : (((ape.macho) - (0x400000)) / 8) < 100 ? 0x30302020 + (((((ape.macho) - (0x400000)) / 8) % 10) << 24) + (((((ape.macho) - (0x400000)) / 8) / 10 % 10) << 16) : (((ape.macho) - (0x400000)) / 8) < 1000 ? 0x30303020 + (((((ape.macho) - (0x400000)) / 8) % 10) << 24) + (((((ape.macho) - (0x400000)) / 8) / 10 % 10) << 16) + (((((ape.macho) - (0x400000)) / 8) / 100 % 10) << 8) : 0x30303030 + (((((ape.macho) - (0x400000)) / 8) % 10) << 24) + (((((ape.macho) - (0x400000)) / 8) / 10 % 10) << 16) + (((((ape.macho) - (0x400000)) / 8) / 100 % 10) << 8) + (((((ape.macho) - (0x400000)) / 8) / 1000 % 10) << 0)));
HIDDEN(.Lape.macho.dd.count_bcs0 = (((.Lape.macho.end - ape.macho) / 8) < 10000 ? 0x20202020 : ((.Lape.macho.end - ape.macho) / 8) < 100000 ? 0x30202020 + ((((.Lape.macho.end - ape.macho) / 8) / 10000 % 10) << 24) : ((.Lape.macho.end - ape.macho) / 8) < 1000000 ? 0x30302020 + ((((.Lape.macho.end - ape.macho) / 8) / 10000 % 10) << 24) + ((((.Lape.macho.end - ape.macho) / 8) / 100000 % 10) << 16) : ((.Lape.macho.end - ape.macho) / 8) < 10000000 ? 0x30303020 + ((((.Lape.macho.end - ape.macho) / 8) / 10000 % 10) << 24) + ((((.Lape.macho.end - ape.macho) / 8) / 100000 % 10) << 16) + ((((.Lape.macho.end - ape.macho) / 8) / 1000000 % 10) << 8) : ((.Lape.macho.end - ape.macho) / 8) < 100000000 ? 0x30303030 + ((((.Lape.macho.end - ape.macho) / 8) / 10000 % 10) << 24) + ((((.Lape.macho.end - ape.macho) / 8) / 100000 % 10) << 16) + ((((.Lape.macho.end - ape.macho) / 8) / 1000000 % 10) << 8) + ((((.Lape.macho.end - ape.macho) / 8) / 10000000 % 10) << 0) : 0xffffffffffffffff)); HIDDEN(.Lape.macho.dd.count_bcs1 = (((.Lape.macho.end - ape.macho) / 8) == 0 ? 0x20202030 : ((.Lape.macho.end - ape.macho) / 8) < 10 ? 0x30202020 + ((((.Lape.macho.end - ape.macho) / 8) % 10) << 24) : ((.Lape.macho.end - ape.macho) / 8) < 100 ? 0x30302020 + ((((.Lape.macho.end - ape.macho) / 8) % 10) << 24) + ((((.Lape.macho.end - ape.macho) / 8) / 10 % 10) << 16) : ((.Lape.macho.end - ape.macho) / 8) < 1000 ? 0x30303020 + ((((.Lape.macho.end - ape.macho) / 8) % 10) << 24) + ((((.Lape.macho.end - ape.macho) / 8) / 10 % 10) << 16) + ((((.Lape.macho.end - ape.macho) / 8) / 100 % 10) << 8) : 0x30303030 + ((((.Lape.macho.end - ape.macho) / 8) % 10) << 24) + ((((.Lape.macho.end - ape.macho) / 8) / 10 % 10) << 16) + ((((.Lape.macho.end - ape.macho) / 8) / 100 % 10) << 8) + ((((.Lape.macho.end - ape.macho) / 8) / 1000 % 10) << 0)));
HIDDEN(.Lape.pe.offset = (ape.pe - ape.mz)); HIDDEN(.Lape.pe.offset_bcs0 = (((((((ape.pe - ape.mz) >> ((0)*8)) >> 0)&0x7) + 0x30) << 24) | ((((((ape.pe - ape.mz) >> ((0)*8)) >> 3)&0x7) + 0x30) << 16) | (((((((ape.pe - ape.mz) >> ((0)*8))&0xff) >> 6)&0x7) + 0x30) << 8) | 0x5c)); HIDDEN(.Lape.pe.offset_bcs1 = (((((((ape.pe - ape.mz) >> ((1)*8)) >> 0)&0x7) + 0x30) << 24) | ((((((ape.pe - ape.mz) >> ((1)*8)) >> 3)&0x7) + 0x30) << 16) | (((((((ape.pe - ape.mz) >> ((1)*8))&0xff) >> 6)&0x7) + 0x30) << 8) | 0x5c)); HIDDEN(.Lape.pe.offset_bcs2 = (((((((ape.pe - ape.mz) >> ((2)*8)) >> 0)&0x7) + 0x30) << 24) | ((((((ape.pe - ape.mz) >> ((2)*8)) >> 3)&0x7) + 0x30) << 16) | (((((((ape.pe - ape.mz) >> ((2)*8))&0xff) >> 6)&0x7) + 0x30) << 8) | 0x5c)); HIDDEN(.Lape.pe.offset_bcs3 = (((((((ape.pe - ape.mz) >> ((3)*8)) >> 0)&0x7) + 0x30) << 24) | ((((((ape.pe - ape.mz) >> ((3)*8)) >> 3)&0x7) + 0x30) << 16) | (((((((ape.pe - ape.mz) >> ((3)*8))&0xff) >> 6)&0x7) + 0x30) << 8) | 0x5c));
HIDDEN(.Lape.pe.optsz = .Lape.pe.sections - (ape.pe + 24));
HIDDEN(.Lape.pe.shnum = (.Lape.pe.sections_end - .Lape.pe.sections) / 40);
HIDDEN(.Lidata.idtsize = idata.idtend - idata.idt);
HIDDEN(.Lidata.iatsize = idata.iatend - idata.iat);
HIDDEN(.Lape.rom.offset = 0);
HIDDEN(.Lape.rom.vaddr = ADDR(.head));
HIDDEN(.Lape.rom.paddr = LOADADDR(.head));
HIDDEN(.Lape.rom.filesz = LOADADDR(.data) - .Lape.rom.paddr);
HIDDEN(.Lape.rom.memsz = ADDR(.data) - ADDR(.head));
HIDDEN(.Lape.rom.align = 0x1000);
HIDDEN(.Lape.rom.rva = ((.Lape.rom.vaddr) - (0x400000)));
HIDDEN(.Lape.ram.offset = .Lape.rom.offset + .Lape.rom.filesz);
HIDDEN(.Lape.ram.vaddr = ADDR(.data));
HIDDEN(.Lape.ram.paddr = LOADADDR(.data));
HIDDEN(.Lape.ram.filesz = LOADADDR(.bss) - LOADADDR(.data));
HIDDEN(.Lape.ram.memsz = ADDR(.bss) + SIZEOF(.bss) - .Lape.ram.vaddr);
HIDDEN(.Lape.ram.align = 0x1000);
HIDDEN(.Lape.ram.rva = ((.Lape.ram.vaddr) - (0x400000)));
HIDDEN(.Lape.note.offset = .Lape.rom.offset + (.Lape.note - .Lape.rom.vaddr));
HIDDEN(.Lape.note.vaddr = .Lape.note);
HIDDEN(.Lape.note.paddr = .Lape.rom.paddr + .Lape.note.offset);
HIDDEN(.Lape.note.filesz = .Lape.note.end - .Lape.note);
HIDDEN(.Lape.note.memsz = .Lape.note.filesz);
HIDDEN(.Lape.note.align = 8);
HIDDEN(.Lape.text.offset = .Lape.rom.offset + LOADADDR(.text) - .Lape.rom.paddr);
HIDDEN(.Lape.text.paddr = LOADADDR(.text));
HIDDEN(.Lape.text.vaddr = ADDR(.text));
HIDDEN(.Lape.text.filesz = SIZEOF(.text));
HIDDEN(.Lape.text.memsz = SIZEOF(.text));
HIDDEN(.Lape.text.align = 4096);
HIDDEN(.Lape.text.rva = ((.Lape.text.vaddr) - (0x400000)));
HIDDEN(.Lape.data.offset = .Lape.ram.offset + LOADADDR(.data) - .Lape.ram.paddr);
HIDDEN(.Lape.data.paddr = LOADADDR(.data));
HIDDEN(.Lape.data.vaddr = ADDR(.data));
HIDDEN(.Lape.data.filesz = SIZEOF(.data));
HIDDEN(.Lape.data.memsz = SIZEOF(.data));
HIDDEN(.Lape.data.align = 0x1000);
HIDDEN(.Lape.data.rva = ((.Lape.data.vaddr) - (0x400000)));
HIDDEN(.Lape.bss.offset = .Lape.ram.offset + LOADADDR(.bss) - .Lape.ram.paddr);
HIDDEN(.Lape.bss.paddr = LOADADDR(.bss));
HIDDEN(.Lape.bss.vaddr = ADDR(.bss));
HIDDEN(.Lape.bss.filesz = 0);
HIDDEN(.Lape.bss.memsz = SIZEOF(.bss));
HIDDEN(.Lape.bss.align = .Lape.data.align);
HIDDEN(v_ape_realsectors =
           (((((((_edata) - (0x400000))) + (4096)-1) & -(4096))) > (0x40000 - (0x1000 + (((0x2240 + 8) + (0x1000)-1) & -(0x1000)))) ? (0x40000 - (0x1000 + (((0x2240 + 8) + (0x1000)-1) & -(0x1000)))) : ((((((_edata) - (0x400000))) + (4096)-1) & -(4096)))) / 512);
HIDDEN(v_ape_realpages = v_ape_realsectors / (4096 / 512));
HIDDEN(v_ape_highsectors =
           ((((((_edata) - (0x400000))) + (512)-1) & -(512)) / 512) - v_ape_realsectors);
HIDDEN(v_ntsubsystem = (DEFINED(GetMessage)
                        ? 2
                        : 3));
HIDDEN(v_zip_cdoffset = DEFINED(__zip_start) ? __zip_start - 0x400000 : 0);;
HIDDEN(v_zip_cdirsize = DEFINED(__zip_start) ? __zip_end - __zip_start : 0);;
HIDDEN(v_zip_records = DEFINED(__zip_start) ? v_zip_cdirsize / (((46 + 248) + (64)-1) & -(64)) : 0);;
HIDDEN(v_zip_commentsize = DEFINED(__zip_start) ? _edata - __zip_end - 22 : 0);;
HIDDEN(uuid1_ = 88172645463325252);
HIDDEN(uuid2_ = 88172645463325252);
uuid1_ = ((uuid1_ | (.Lape.bss.align >> 12)) - (uuid1_ & (.Lape.bss.align >> 12))); uuid1_ = ((uuid1_ | (.Lape.bss.align << 25)) - (uuid1_ & (.Lape.bss.align << 25))); uuid1_ = ((uuid1_ | (.Lape.bss.align >> 27)) - (uuid1_ & (.Lape.bss.align >> 27))); uuid1_ = (uuid1_ + (.Lape.bss.align >> 000) & 0xFF) * 0x9e3779b9925d4c17; uuid1_ = (uuid1_ + (.Lape.bss.align >> 010) & 0xFF) * 0x9e3779b9925d4c17; uuid1_ = (uuid1_ + (.Lape.bss.align >> 020) & 0xFF) * 0x9e3779b9925d4c17; uuid1_ = (uuid1_ + (.Lape.bss.align >> 030) & 0xFF) * 0x9e3779b9925d4c17; uuid2_ = ((uuid2_ | (.Lape.bss.align >> 12)) - (uuid2_ & (.Lape.bss.align >> 12))); uuid2_ = ((uuid2_ | (.Lape.bss.align << 25)) - (uuid2_ & (.Lape.bss.align << 25))); uuid2_ = ((uuid2_ | (.Lape.bss.align >> 27)) - (uuid2_ & (.Lape.bss.align >> 27))); uuid2_ = (uuid2_ + (.Lape.bss.align >> 000) & 0xFF) * 0x9e3779b9925d4c17; uuid2_ = (uuid2_ + (.Lape.bss.align >> 010) & 0xFF) * 0x9e3779b9925d4c17; uuid2_ = (uuid2_ + (.Lape.bss.align >> 020) & 0xFF) * 0x9e3779b9925d4c17; uuid2_ = (uuid2_ + (.Lape.bss.align >> 030) & 0xFF) * 0x9e3779b9925d4c17;
uuid1_ = ((uuid1_ | (.Lape.bss.filesz >> 12)) - (uuid1_ & (.Lape.bss.filesz >> 12))); uuid1_ = ((uuid1_ | (.Lape.bss.filesz << 25)) - (uuid1_ & (.Lape.bss.filesz << 25))); uuid1_ = ((uuid1_ | (.Lape.bss.filesz >> 27)) - (uuid1_ & (.Lape.bss.filesz >> 27))); uuid1_ = (uuid1_ + (.Lape.bss.filesz >> 000) & 0xFF) * 0x9e3779b9925d4c17; uuid1_ = (uuid1_ + (.Lape.bss.filesz >> 010) & 0xFF) * 0x9e3779b9925d4c17; uuid1_ = (uuid1_ + (.Lape.bss.filesz >> 020) & 0xFF) * 0x9e3779b9925d4c17; uuid1_ = (uuid1_ + (.Lape.bss.filesz >> 030) & 0xFF) * 0x9e3779b9925d4c17; uuid2_ = ((uuid2_ | (.Lape.bss.filesz >> 12)) - (uuid2_ & (.Lape.bss.filesz >> 12))); uuid2_ = ((uuid2_ | (.Lape.bss.filesz << 25)) - (uuid2_ & (.Lape.bss.filesz << 25))); uuid2_ = ((uuid2_ | (.Lape.bss.filesz >> 27)) - (uuid2_ & (.Lape.bss.filesz >> 27))); uuid2_ = (uuid2_ + (.Lape.bss.filesz >> 000) & 0xFF) * 0x9e3779b9925d4c17; uuid2_ = (uuid2_ + (.Lape.bss.filesz >> 010) & 0xFF) * 0x9e3779b9925d4c17; uuid2_ = (uuid2_ + (.Lape.bss.filesz >> 020) & 0xFF) * 0x9e3779b9925d4c17; uuid2_ = (uuid2_ + (.Lape.bss.filesz >> 030) & 0xFF) * 0x9e3779b9925d4c17;
uuid1_ = ((uuid1_ | (.Lape.bss.memsz >> 12)) - (uuid1_ & (.Lape.bss.memsz >> 12))); uuid1_ = ((uuid1_ | (.Lape.bss.memsz << 25)) - (uuid1_ & (.Lape.bss.memsz << 25))); uuid1_ = ((uuid1_ | (.Lape.bss.memsz >> 27)) - (uuid1_ & (.Lape.bss.memsz >> 27))); uuid1_ = (uuid1_ + (.Lape.bss.memsz >> 000) & 0xFF) * 0x9e3779b9925d4c17; uuid1_ = (uuid1_ + (.Lape.bss.memsz >> 010) & 0xFF) * 0x9e3779b9925d4c17; uuid1_ = (uuid1_ + (.Lape.bss.memsz >> 020) & 0xFF) * 0x9e3779b9925d4c17; uuid1_ = (uuid1_ + (.Lape.bss.memsz >> 030) & 0xFF) * 0x9e3779b9925d4c17; uuid2_ = ((uuid2_ | (.Lape.bss.memsz >> 12)) - (uuid2_ & (.Lape.bss.memsz >> 12))); uuid2_ = ((uuid2_ | (.Lape.bss.memsz << 25)) - (uuid2_ & (.Lape.bss.memsz << 25))); uuid2_ = ((uuid2_ | (.Lape.bss.memsz >> 27)) - (uuid2_ & (.Lape.bss.memsz >> 27))); uuid2_ = (uuid2_ + (.Lape.bss.memsz >> 000) & 0xFF) * 0x9e3779b9925d4c17; uuid2_ = (uuid2_ + (.Lape.bss.memsz >> 010) & 0xFF) * 0x9e3779b9925d4c17; uuid2_ = (uuid2_ + (.Lape.bss.memsz >> 020) & 0xFF) * 0x9e3779b9925d4c17; uuid2_ = (uuid2_ + (.Lape.bss.memsz >> 030) & 0xFF) * 0x9e3779b9925d4c17;
uuid1_ = ((uuid1_ | (.Lape.bss.offset >> 12)) - (uuid1_ & (.Lape.bss.offset >> 12))); uuid1_ = ((uuid1_ | (.Lape.bss.offset << 25)) - (uuid1_ & (.Lape.bss.offset << 25))); uuid1_ = ((uuid1_ | (.Lape.bss.offset >> 27)) - (uuid1_ & (.Lape.bss.offset >> 27))); uuid1_ = (uuid1_ + (.Lape.bss.offset >> 000) & 0xFF) * 0x9e3779b9925d4c17; uuid1_ = (uuid1_ + (.Lape.bss.offset >> 010) & 0xFF) * 0x9e3779b9925d4c17; uuid1_ = (uuid1_ + (.Lape.bss.offset >> 020) & 0xFF) * 0x9e3779b9925d4c17; uuid1_ = (uuid1_ + (.Lape.bss.offset >> 030) & 0xFF) * 0x9e3779b9925d4c17; uuid2_ = ((uuid2_ | (.Lape.bss.offset >> 12)) - (uuid2_ & (.Lape.bss.offset >> 12))); uuid2_ = ((uuid2_ | (.Lape.bss.offset << 25)) - (uuid2_ & (.Lape.bss.offset << 25))); uuid2_ = ((uuid2_ | (.Lape.bss.offset >> 27)) - (uuid2_ & (.Lape.bss.offset >> 27))); uuid2_ = (uuid2_ + (.Lape.bss.offset >> 000) & 0xFF) * 0x9e3779b9925d4c17; uuid2_ = (uuid2_ + (.Lape.bss.offset >> 010) & 0xFF) * 0x9e3779b9925d4c17; uuid2_ = (uuid2_ + (.Lape.bss.offset >> 020) & 0xFF) * 0x9e3779b9925d4c17; uuid2_ = (uuid2_ + (.Lape.bss.offset >> 030) & 0xFF) * 0x9e3779b9925d4c17;
uuid1_ = ((uuid1_ | (.Lape.bss.paddr >> 12)) - (uuid1_ & (.Lape.bss.paddr >> 12))); uuid1_ = ((uuid1_ | (.Lape.bss.paddr << 25)) - (uuid1_ & (.Lape.bss.paddr << 25))); uuid1_ = ((uuid1_ | (.Lape.bss.paddr >> 27)) - (uuid1_ & (.Lape.bss.paddr >> 27))); uuid1_ = (uuid1_ + (.Lape.bss.paddr >> 000) & 0xFF) * 0x9e3779b9925d4c17; uuid1_ = (uuid1_ + (.Lape.bss.paddr >> 010) & 0xFF) * 0x9e3779b9925d4c17; uuid1_ = (uuid1_ + (.Lape.bss.paddr >> 020) & 0xFF) * 0x9e3779b9925d4c17; uuid1_ = (uuid1_ + (.Lape.bss.paddr >> 030) & 0xFF) * 0x9e3779b9925d4c17; uuid2_ = ((uuid2_ | (.Lape.bss.paddr >> 12)) - (uuid2_ & (.Lape.bss.paddr >> 12))); uuid2_ = ((uuid2_ | (.Lape.bss.paddr << 25)) - (uuid2_ & (.Lape.bss.paddr << 25))); uuid2_ = ((uuid2_ | (.Lape.bss.paddr >> 27)) - (uuid2_ & (.Lape.bss.paddr >> 27))); uuid2_ = (uuid2_ + (.Lape.bss.paddr >> 000) & 0xFF) * 0x9e3779b9925d4c17; uuid2_ = (uuid2_ + (.Lape.bss.paddr >> 010) & 0xFF) * 0x9e3779b9925d4c17; uuid2_ = (uuid2_ + (.Lape.bss.paddr >> 020) & 0xFF) * 0x9e3779b9925d4c17; uuid2_ = (uuid2_ + (.Lape.bss.paddr >> 030) & 0xFF) * 0x9e3779b9925d4c17;
uuid1_ = ((uuid1_ | (.Lape.data.align >> 12)) - (uuid1_ & (.Lape.data.align >> 12))); uuid1_ = ((uuid1_ | (.Lape.data.align << 25)) - (uuid1_ & (.Lape.data.align << 25))); uuid1_ = ((uuid1_ | (.Lape.data.align >> 27)) - (uuid1_ & (.Lape.data.align >> 27))); uuid1_ = (uuid1_ + (.Lape.data.align >> 000) & 0xFF) * 0x9e3779b9925d4c17; uuid1_ = (uuid1_ + (.Lape.data.align >> 010) & 0xFF) * 0x9e3779b9925d4c17; uuid1_ = (uuid1_ + (.Lape.data.align >> 020) & 0xFF) * 0x9e3779b9925d4c17; uuid1_ = (uuid1_ + (.Lape.data.align >> 030) & 0xFF) * 0x9e3779b9925d4c17; uuid2_ = ((uuid2_ | (.Lape.data.align >> 12)) - (uuid2_ & (.Lape.data.align >> 12))); uuid2_ = ((uuid2_ | (.Lape.data.align << 25)) - (uuid2_ & (.Lape.data.align << 25))); uuid2_ = ((uuid2_ | (.Lape.data.align >> 27)) - (uuid2_ & (.Lape.data.align >> 27))); uuid2_ = (uuid2_ + (.Lape.data.align >> 000) & 0xFF) * 0x9e3779b9925d4c17; uuid2_ = (uuid2_ + (.Lape.data.align >> 010) & 0xFF) * 0x9e3779b9925d4c17; uuid2_ = (uuid2_ + (.Lape.data.align >> 020) & 0xFF) * 0x9e3779b9925d4c17; uuid2_ = (uuid2_ + (.Lape.data.align >> 030) & 0xFF) * 0x9e3779b9925d4c17;
uuid1_ = ((uuid1_ | (.Lape.data.filesz >> 12)) - (uuid1_ & (.Lape.data.filesz >> 12))); uuid1_ = ((uuid1_ | (.Lape.data.filesz << 25)) - (uuid1_ & (.Lape.data.filesz << 25))); uuid1_ = ((uuid1_ | (.Lape.data.filesz >> 27)) - (uuid1_ & (.Lape.data.filesz >> 27))); uuid1_ = (uuid1_ + (.Lape.data.filesz >> 000) & 0xFF) * 0x9e3779b9925d4c17; uuid1_ = (uuid1_ + (.Lape.data.filesz >> 010) & 0xFF) * 0x9e3779b9925d4c17; uuid1_ = (uuid1_ + (.Lape.data.filesz >> 020) & 0xFF) * 0x9e3779b9925d4c17; uuid1_ = (uuid1_ + (.Lape.data.filesz >> 030) & 0xFF) * 0x9e3779b9925d4c17; uuid2_ = ((uuid2_ | (.Lape.data.filesz >> 12)) - (uuid2_ & (.Lape.data.filesz >> 12))); uuid2_ = ((uuid2_ | (.Lape.data.filesz << 25)) - (uuid2_ & (.Lape.data.filesz << 25))); uuid2_ = ((uuid2_ | (.Lape.data.filesz >> 27)) - (uuid2_ & (.Lape.data.filesz >> 27))); uuid2_ = (uuid2_ + (.Lape.data.filesz >> 000) & 0xFF) * 0x9e3779b9925d4c17; uuid2_ = (uuid2_ + (.Lape.data.filesz >> 010) & 0xFF) * 0x9e3779b9925d4c17; uuid2_ = (uuid2_ + (.Lape.data.filesz >> 020) & 0xFF) * 0x9e3779b9925d4c17; uuid2_ = (uuid2_ + (.Lape.data.filesz >> 030) & 0xFF) * 0x9e3779b9925d4c17;
uuid1_ = ((uuid1_ | (.Lape.data.memsz >> 12)) - (uuid1_ & (.Lape.data.memsz >> 12))); uuid1_ = ((uuid1_ | (.Lape.data.memsz << 25)) - (uuid1_ & (.Lape.data.memsz << 25))); uuid1_ = ((uuid1_ | (.Lape.data.memsz >> 27)) - (uuid1_ & (.Lape.data.memsz >> 27))); uuid1_ = (uuid1_ + (.Lape.data.memsz >> 000) & 0xFF) * 0x9e3779b9925d4c17; uuid1_ = (uuid1_ + (.Lape.data.memsz >> 010) & 0xFF) * 0x9e3779b9925d4c17; uuid1_ = (uuid1_ + (.Lape.data.memsz >> 020) & 0xFF) * 0x9e3779b9925d4c17; uuid1_ = (uuid1_ + (.Lape.data.memsz >> 030) & 0xFF) * 0x9e3779b9925d4c17; uuid2_ = ((uuid2_ | (.Lape.data.memsz >> 12)) - (uuid2_ & (.Lape.data.memsz >> 12))); uuid2_ = ((uuid2_ | (.Lape.data.memsz << 25)) - (uuid2_ & (.Lape.data.memsz << 25))); uuid2_ = ((uuid2_ | (.Lape.data.memsz >> 27)) - (uuid2_ & (.Lape.data.memsz >> 27))); uuid2_ = (uuid2_ + (.Lape.data.memsz >> 000) & 0xFF) * 0x9e3779b9925d4c17; uuid2_ = (uuid2_ + (.Lape.data.memsz >> 010) & 0xFF) * 0x9e3779b9925d4c17; uuid2_ = (uuid2_ + (.Lape.data.memsz >> 020) & 0xFF) * 0x9e3779b9925d4c17; uuid2_ = (uuid2_ + (.Lape.data.memsz >> 030) & 0xFF) * 0x9e3779b9925d4c17;
uuid1_ = ((uuid1_ | (.Lape.data.offset >> 12)) - (uuid1_ & (.Lape.data.offset >> 12))); uuid1_ = ((uuid1_ | (.Lape.data.offset << 25)) - (uuid1_ & (.Lape.data.offset << 25))); uuid1_ = ((uuid1_ | (.Lape.data.offset >> 27)) - (uuid1_ & (.Lape.data.offset >> 27))); uuid1_ = (uuid1_ + (.Lape.data.offset >> 000) & 0xFF) * 0x9e3779b9925d4c17; uuid1_ = (uuid1_ + (.Lape.data.offset >> 010) & 0xFF) * 0x9e3779b9925d4c17; uuid1_ = (uuid1_ + (.Lape.data.offset >> 020) & 0xFF) * 0x9e3779b9925d4c17; uuid1_ = (uuid1_ + (.Lape.data.offset >> 030) & 0xFF) * 0x9e3779b9925d4c17; uuid2_ = ((uuid2_ | (.Lape.data.offset >> 12)) - (uuid2_ & (.Lape.data.offset >> 12))); uuid2_ = ((uuid2_ | (.Lape.data.offset << 25)) - (uuid2_ & (.Lape.data.offset << 25))); uuid2_ = ((uuid2_ | (.Lape.data.offset >> 27)) - (uuid2_ & (.Lape.data.offset >> 27))); uuid2_ = (uuid2_ + (.Lape.data.offset >> 000) & 0xFF) * 0x9e3779b9925d4c17; uuid2_ = (uuid2_ + (.Lape.data.offset >> 010) & 0xFF) * 0x9e3779b9925d4c17; uuid2_ = (uuid2_ + (.Lape.data.offset >> 020) & 0xFF) * 0x9e3779b9925d4c17; uuid2_ = (uuid2_ + (.Lape.data.offset >> 030) & 0xFF) * 0x9e3779b9925d4c17;
uuid1_ = ((uuid1_ | (.Lape.data.paddr >> 12)) - (uuid1_ & (.Lape.data.paddr >> 12))); uuid1_ = ((uuid1_ | (.Lape.data.paddr << 25)) - (uuid1_ & (.Lape.data.paddr << 25))); uuid1_ = ((uuid1_ | (.Lape.data.paddr >> 27)) - (uuid1_ & (.Lape.data.paddr >> 27))); uuid1_ = (uuid1_ + (.Lape.data.paddr >> 000) & 0xFF) * 0x9e3779b9925d4c17; uuid1_ = (uuid1_ + (.Lape.data.paddr >> 010) & 0xFF) * 0x9e3779b9925d4c17; uuid1_ = (uuid1_ + (.Lape.data.paddr >> 020) & 0xFF) * 0x9e3779b9925d4c17; uuid1_ = (uuid1_ + (.Lape.data.paddr >> 030) & 0xFF) * 0x9e3779b9925d4c17; uuid2_ = ((uuid2_ | (.Lape.data.paddr >> 12)) - (uuid2_ & (.Lape.data.paddr >> 12))); uuid2_ = ((uuid2_ | (.Lape.data.paddr << 25)) - (uuid2_ & (.Lape.data.paddr << 25))); uuid2_ = ((uuid2_ | (.Lape.data.paddr >> 27)) - (uuid2_ & (.Lape.data.paddr >> 27))); uuid2_ = (uuid2_ + (.Lape.data.paddr >> 000) & 0xFF) * 0x9e3779b9925d4c17; uuid2_ = (uuid2_ + (.Lape.data.paddr >> 010) & 0xFF) * 0x9e3779b9925d4c17; uuid2_ = (uuid2_ + (.Lape.data.paddr >> 020) & 0xFF) * 0x9e3779b9925d4c17; uuid2_ = (uuid2_ + (.Lape.data.paddr >> 030) & 0xFF) * 0x9e3779b9925d4c17;
uuid1_ = ((uuid1_ | (.Lape.data.rva >> 12)) - (uuid1_ & (.Lape.data.rva >> 12))); uuid1_ = ((uuid1_ | (.Lape.data.rva << 25)) - (uuid1_ & (.Lape.data.rva << 25))); uuid1_ = ((uuid1_ | (.Lape.data.rva >> 27)) - (uuid1_ & (.Lape.data.rva >> 27))); uuid1_ = (uuid1_ + (.Lape.data.rva >> 000) & 0xFF) * 0x9e3779b9925d4c17; uuid1_ = (uuid1_ + (.Lape.data.rva >> 010) & 0xFF) * 0x9e3779b9925d4c17; uuid1_ = (uuid1_ + (.Lape.data.rva >> 020) & 0xFF) * 0x9e3779b9925d4c17; uuid1_ = (uuid1_ + (.Lape.data.rva >> 030) & 0xFF) * 0x9e3779b9925d4c17; uuid2_ = ((uuid2_ | (.Lape.data.rva >> 12)) - (uuid2_ & (.Lape.data.rva >> 12))); uuid2_ = ((uuid2_ | (.Lape.data.rva << 25)) - (uuid2_ & (.Lape.data.rva << 25))); uuid2_ = ((uuid2_ | (.Lape.data.rva >> 27)) - (uuid2_ & (.Lape.data.rva >> 27))); uuid2_ = (uuid2_ + (.Lape.data.rva >> 000) & 0xFF) * 0x9e3779b9925d4c17; uuid2_ = (uuid2_ + (.Lape.data.rva >> 010) & 0xFF) * 0x9e3779b9925d4c17; uuid2_ = (uuid2_ + (.Lape.data.rva >> 020) & 0xFF) * 0x9e3779b9925d4c17; uuid2_ = (uuid2_ + (.Lape.data.rva >> 030) & 0xFF) * 0x9e3779b9925d4c17;
uuid1_ = ((uuid1_ | (.Lape.data.vaddr >> 12)) - (uuid1_ & (.Lape.data.vaddr >> 12))); uuid1_ = ((uuid1_ | (.Lape.data.vaddr << 25)) - (uuid1_ & (.Lape.data.vaddr << 25))); uuid1_ = ((uuid1_ | (.Lape.data.vaddr >> 27)) - (uuid1_ & (.Lape.data.vaddr >> 27))); uuid1_ = (uuid1_ + (.Lape.data.vaddr >> 000) & 0xFF) * 0x9e3779b9925d4c17; uuid1_ = (uuid1_ + (.Lape.data.vaddr >> 010) & 0xFF) * 0x9e3779b9925d4c17; uuid1_ = (uuid1_ + (.Lape.data.vaddr >> 020) & 0xFF) * 0x9e3779b9925d4c17; uuid1_ = (uuid1_ + (.Lape.data.vaddr >> 030) & 0xFF) * 0x9e3779b9925d4c17; uuid2_ = ((uuid2_ | (.Lape.data.vaddr >> 12)) - (uuid2_ & (.Lape.data.vaddr >> 12))); uuid2_ = ((uuid2_ | (.Lape.data.vaddr << 25)) - (uuid2_ & (.Lape.data.vaddr << 25))); uuid2_ = ((uuid2_ | (.Lape.data.vaddr >> 27)) - (uuid2_ & (.Lape.data.vaddr >> 27))); uuid2_ = (uuid2_ + (.Lape.data.vaddr >> 000) & 0xFF) * 0x9e3779b9925d4c17; uuid2_ = (uuid2_ + (.Lape.data.vaddr >> 010) & 0xFF) * 0x9e3779b9925d4c17; uuid2_ = (uuid2_ + (.Lape.data.vaddr >> 020) & 0xFF) * 0x9e3779b9925d4c17; uuid2_ = (uuid2_ + (.Lape.data.vaddr >> 030) & 0xFF) * 0x9e3779b9925d4c17;
uuid1_ = ((uuid1_ | (.Lape.elf.entry >> 12)) - (uuid1_ & (.Lape.elf.entry >> 12))); uuid1_ = ((uuid1_ | (.Lape.elf.entry << 25)) - (uuid1_ & (.Lape.elf.entry << 25))); uuid1_ = ((uuid1_ | (.Lape.elf.entry >> 27)) - (uuid1_ & (.Lape.elf.entry >> 27))); uuid1_ = (uuid1_ + (.Lape.elf.entry >> 000) & 0xFF) * 0x9e3779b9925d4c17; uuid1_ = (uuid1_ + (.Lape.elf.entry >> 010) & 0xFF) * 0x9e3779b9925d4c17; uuid1_ = (uuid1_ + (.Lape.elf.entry >> 020) & 0xFF) * 0x9e3779b9925d4c17; uuid1_ = (uuid1_ + (.Lape.elf.entry >> 030) & 0xFF) * 0x9e3779b9925d4c17; uuid2_ = ((uuid2_ | (.Lape.elf.entry >> 12)) - (uuid2_ & (.Lape.elf.entry >> 12))); uuid2_ = ((uuid2_ | (.Lape.elf.entry << 25)) - (uuid2_ & (.Lape.elf.entry << 25))); uuid2_ = ((uuid2_ | (.Lape.elf.entry >> 27)) - (uuid2_ & (.Lape.elf.entry >> 27))); uuid2_ = (uuid2_ + (.Lape.elf.entry >> 000) & 0xFF) * 0x9e3779b9925d4c17; uuid2_ = (uuid2_ + (.Lape.elf.entry >> 010) & 0xFF) * 0x9e3779b9925d4c17; uuid2_ = (uuid2_ + (.Lape.elf.entry >> 020) & 0xFF) * 0x9e3779b9925d4c17; uuid2_ = (uuid2_ + (.Lape.elf.entry >> 030) & 0xFF) * 0x9e3779b9925d4c17;
uuid1_ = ((uuid1_ | (.Lape.elf.phnum >> 12)) - (uuid1_ & (.Lape.elf.phnum >> 12))); uuid1_ = ((uuid1_ | (.Lape.elf.phnum << 25)) - (uuid1_ & (.Lape.elf.phnum << 25))); uuid1_ = ((uuid1_ | (.Lape.elf.phnum >> 27)) - (uuid1_ & (.Lape.elf.phnum >> 27))); uuid1_ = (uuid1_ + (.Lape.elf.phnum >> 000) & 0xFF) * 0x9e3779b9925d4c17; uuid1_ = (uuid1_ + (.Lape.elf.phnum >> 010) & 0xFF) * 0x9e3779b9925d4c17; uuid1_ = (uuid1_ + (.Lape.elf.phnum >> 020) & 0xFF) * 0x9e3779b9925d4c17; uuid1_ = (uuid1_ + (.Lape.elf.phnum >> 030) & 0xFF) * 0x9e3779b9925d4c17; uuid2_ = ((uuid2_ | (.Lape.elf.phnum >> 12)) - (uuid2_ & (.Lape.elf.phnum >> 12))); uuid2_ = ((uuid2_ | (.Lape.elf.phnum << 25)) - (uuid2_ & (.Lape.elf.phnum << 25))); uuid2_ = ((uuid2_ | (.Lape.elf.phnum >> 27)) - (uuid2_ & (.Lape.elf.phnum >> 27))); uuid2_ = (uuid2_ + (.Lape.elf.phnum >> 000) & 0xFF) * 0x9e3779b9925d4c17; uuid2_ = (uuid2_ + (.Lape.elf.phnum >> 010) & 0xFF) * 0x9e3779b9925d4c17; uuid2_ = (uuid2_ + (.Lape.elf.phnum >> 020) & 0xFF) * 0x9e3779b9925d4c17; uuid2_ = (uuid2_ + (.Lape.elf.phnum >> 030) & 0xFF) * 0x9e3779b9925d4c17;
uuid1_ = ((uuid1_ | (.Lape.elf.phoff >> 12)) - (uuid1_ & (.Lape.elf.phoff >> 12))); uuid1_ = ((uuid1_ | (.Lape.elf.phoff << 25)) - (uuid1_ & (.Lape.elf.phoff << 25))); uuid1_ = ((uuid1_ | (.Lape.elf.phoff >> 27)) - (uuid1_ & (.Lape.elf.phoff >> 27))); uuid1_ = (uuid1_ + (.Lape.elf.phoff >> 000) & 0xFF) * 0x9e3779b9925d4c17; uuid1_ = (uuid1_ + (.Lape.elf.phoff >> 010) & 0xFF) * 0x9e3779b9925d4c17; uuid1_ = (uuid1_ + (.Lape.elf.phoff >> 020) & 0xFF) * 0x9e3779b9925d4c17; uuid1_ = (uuid1_ + (.Lape.elf.phoff >> 030) & 0xFF) * 0x9e3779b9925d4c17; uuid2_ = ((uuid2_ | (.Lape.elf.phoff >> 12)) - (uuid2_ & (.Lape.elf.phoff >> 12))); uuid2_ = ((uuid2_ | (.Lape.elf.phoff << 25)) - (uuid2_ & (.Lape.elf.phoff << 25))); uuid2_ = ((uuid2_ | (.Lape.elf.phoff >> 27)) - (uuid2_ & (.Lape.elf.phoff >> 27))); uuid2_ = (uuid2_ + (.Lape.elf.phoff >> 000) & 0xFF) * 0x9e3779b9925d4c17; uuid2_ = (uuid2_ + (.Lape.elf.phoff >> 010) & 0xFF) * 0x9e3779b9925d4c17; uuid2_ = (uuid2_ + (.Lape.elf.phoff >> 020) & 0xFF) * 0x9e3779b9925d4c17; uuid2_ = (uuid2_ + (.Lape.elf.phoff >> 030) & 0xFF) * 0x9e3779b9925d4c17;
uuid1_ = ((uuid1_ | (.Lape.elf.shnum >> 12)) - (uuid1_ & (.Lape.elf.shnum >> 12))); uuid1_ = ((uuid1_ | (.Lape.elf.shnum << 25)) - (uuid1_ & (.Lape.elf.shnum << 25))); uuid1_ = ((uuid1_ | (.Lape.elf.shnum >> 27)) - (uuid1_ & (.Lape.elf.shnum >> 27))); uuid1_ = (uuid1_ + (.Lape.elf.shnum >> 000) & 0xFF) * 0x9e3779b9925d4c17; uuid1_ = (uuid1_ + (.Lape.elf.shnum >> 010) & 0xFF) * 0x9e3779b9925d4c17; uuid1_ = (uuid1_ + (.Lape.elf.shnum >> 020) & 0xFF) * 0x9e3779b9925d4c17; uuid1_ = (uuid1_ + (.Lape.elf.shnum >> 030) & 0xFF) * 0x9e3779b9925d4c17; uuid2_ = ((uuid2_ | (.Lape.elf.shnum >> 12)) - (uuid2_ & (.Lape.elf.shnum >> 12))); uuid2_ = ((uuid2_ | (.Lape.elf.shnum << 25)) - (uuid2_ & (.Lape.elf.shnum << 25))); uuid2_ = ((uuid2_ | (.Lape.elf.shnum >> 27)) - (uuid2_ & (.Lape.elf.shnum >> 27))); uuid2_ = (uuid2_ + (.Lape.elf.shnum >> 000) & 0xFF) * 0x9e3779b9925d4c17; uuid2_ = (uuid2_ + (.Lape.elf.shnum >> 010) & 0xFF) * 0x9e3779b9925d4c17; uuid2_ = (uuid2_ + (.Lape.elf.shnum >> 020) & 0xFF) * 0x9e3779b9925d4c17; uuid2_ = (uuid2_ + (.Lape.elf.shnum >> 030) & 0xFF) * 0x9e3779b9925d4c17;
uuid1_ = ((uuid1_ | (.Lape.elf.shoff >> 12)) - (uuid1_ & (.Lape.elf.shoff >> 12))); uuid1_ = ((uuid1_ | (.Lape.elf.shoff << 25)) - (uuid1_ & (.Lape.elf.shoff << 25))); uuid1_ = ((uuid1_ | (.Lape.elf.shoff >> 27)) - (uuid1_ & (.Lape.elf.shoff >> 27))); uuid1_ = (uuid1_ + (.Lape.elf.shoff >> 000) & 0xFF) * 0x9e3779b9925d4c17; uuid1_ = (uuid1_ + (.Lape.elf.shoff >> 010) & 0xFF) * 0x9e3779b9925d4c17; uuid1_ = (uuid1_ + (.Lape.elf.shoff >> 020) & 0xFF) * 0x9e3779b9925d4c17; uuid1_ = (uuid1_ + (.Lape.elf.shoff >> 030) & 0xFF) * 0x9e3779b9925d4c17; uuid2_ = ((uuid2_ | (.Lape.elf.shoff >> 12)) - (uuid2_ & (.Lape.elf.shoff >> 12))); uuid2_ = ((uuid2_ | (.Lape.elf.shoff << 25)) - (uuid2_ & (.Lape.elf.shoff << 25))); uuid2_ = ((uuid2_ | (.Lape.elf.shoff >> 27)) - (uuid2_ & (.Lape.elf.shoff >> 27))); uuid2_ = (uuid2_ + (.Lape.elf.shoff >> 000) & 0xFF) * 0x9e3779b9925d4c17; uuid2_ = (uuid2_ + (.Lape.elf.shoff >> 010) & 0xFF) * 0x9e3779b9925d4c17; uuid2_ = (uuid2_ + (.Lape.elf.shoff >> 020) & 0xFF) * 0x9e3779b9925d4c17; uuid2_ = (uuid2_ + (.Lape.elf.shoff >> 030) & 0xFF) * 0x9e3779b9925d4c17;
uuid1_ = ((uuid1_ | (.Lape.elf.shstrndx >> 12)) - (uuid1_ & (.Lape.elf.shstrndx >> 12))); uuid1_ = ((uuid1_ | (.Lape.elf.shstrndx << 25)) - (uuid1_ & (.Lape.elf.shstrndx << 25))); uuid1_ = ((uuid1_ | (.Lape.elf.shstrndx >> 27)) - (uuid1_ & (.Lape.elf.shstrndx >> 27))); uuid1_ = (uuid1_ + (.Lape.elf.shstrndx >> 000) & 0xFF) * 0x9e3779b9925d4c17; uuid1_ = (uuid1_ + (.Lape.elf.shstrndx >> 010) & 0xFF) * 0x9e3779b9925d4c17; uuid1_ = (uuid1_ + (.Lape.elf.shstrndx >> 020) & 0xFF) * 0x9e3779b9925d4c17; uuid1_ = (uuid1_ + (.Lape.elf.shstrndx >> 030) & 0xFF) * 0x9e3779b9925d4c17; uuid2_ = ((uuid2_ | (.Lape.elf.shstrndx >> 12)) - (uuid2_ & (.Lape.elf.shstrndx >> 12))); uuid2_ = ((uuid2_ | (.Lape.elf.shstrndx << 25)) - (uuid2_ & (.Lape.elf.shstrndx << 25))); uuid2_ = ((uuid2_ | (.Lape.elf.shstrndx >> 27)) - (uuid2_ & (.Lape.elf.shstrndx >> 27))); uuid2_ = (uuid2_ + (.Lape.elf.shstrndx >> 000) & 0xFF) * 0x9e3779b9925d4c17; uuid2_ = (uuid2_ + (.Lape.elf.shstrndx >> 010) & 0xFF) * 0x9e3779b9925d4c17; uuid2_ = (uuid2_ + (.Lape.elf.shstrndx >> 020) & 0xFF) * 0x9e3779b9925d4c17; uuid2_ = (uuid2_ + (.Lape.elf.shstrndx >> 030) & 0xFF) * 0x9e3779b9925d4c17;
uuid1_ = ((uuid1_ | (.Lape.macho.end >> 12)) - (uuid1_ & (.Lape.macho.end >> 12))); uuid1_ = ((uuid1_ | (.Lape.macho.end << 25)) - (uuid1_ & (.Lape.macho.end << 25))); uuid1_ = ((uuid1_ | (.Lape.macho.end >> 27)) - (uuid1_ & (.Lape.macho.end >> 27))); uuid1_ = (uuid1_ + (.Lape.macho.end >> 000) & 0xFF) * 0x9e3779b9925d4c17; uuid1_ = (uuid1_ + (.Lape.macho.end >> 010) & 0xFF) * 0x9e3779b9925d4c17; uuid1_ = (uuid1_ + (.Lape.macho.end >> 020) & 0xFF) * 0x9e3779b9925d4c17; uuid1_ = (uuid1_ + (.Lape.macho.end >> 030) & 0xFF) * 0x9e3779b9925d4c17; uuid2_ = ((uuid2_ | (.Lape.macho.end >> 12)) - (uuid2_ & (.Lape.macho.end >> 12))); uuid2_ = ((uuid2_ | (.Lape.macho.end << 25)) - (uuid2_ & (.Lape.macho.end << 25))); uuid2_ = ((uuid2_ | (.Lape.macho.end >> 27)) - (uuid2_ & (.Lape.macho.end >> 27))); uuid2_ = (uuid2_ + (.Lape.macho.end >> 000) & 0xFF) * 0x9e3779b9925d4c17; uuid2_ = (uuid2_ + (.Lape.macho.end >> 010) & 0xFF) * 0x9e3779b9925d4c17; uuid2_ = (uuid2_ + (.Lape.macho.end >> 020) & 0xFF) * 0x9e3779b9925d4c17; uuid2_ = (uuid2_ + (.Lape.macho.end >> 030) & 0xFF) * 0x9e3779b9925d4c17;
uuid1_ = ((uuid1_ | (.Lape.note >> 12)) - (uuid1_ & (.Lape.note >> 12))); uuid1_ = ((uuid1_ | (.Lape.note << 25)) - (uuid1_ & (.Lape.note << 25))); uuid1_ = ((uuid1_ | (.Lape.note >> 27)) - (uuid1_ & (.Lape.note >> 27))); uuid1_ = (uuid1_ + (.Lape.note >> 000) & 0xFF) * 0x9e3779b9925d4c17; uuid1_ = (uuid1_ + (.Lape.note >> 010) & 0xFF) * 0x9e3779b9925d4c17; uuid1_ = (uuid1_ + (.Lape.note >> 020) & 0xFF) * 0x9e3779b9925d4c17; uuid1_ = (uuid1_ + (.Lape.note >> 030) & 0xFF) * 0x9e3779b9925d4c17; uuid2_ = ((uuid2_ | (.Lape.note >> 12)) - (uuid2_ & (.Lape.note >> 12))); uuid2_ = ((uuid2_ | (.Lape.note << 25)) - (uuid2_ & (.Lape.note << 25))); uuid2_ = ((uuid2_ | (.Lape.note >> 27)) - (uuid2_ & (.Lape.note >> 27))); uuid2_ = (uuid2_ + (.Lape.note >> 000) & 0xFF) * 0x9e3779b9925d4c17; uuid2_ = (uuid2_ + (.Lape.note >> 010) & 0xFF) * 0x9e3779b9925d4c17; uuid2_ = (uuid2_ + (.Lape.note >> 020) & 0xFF) * 0x9e3779b9925d4c17; uuid2_ = (uuid2_ + (.Lape.note >> 030) & 0xFF) * 0x9e3779b9925d4c17;
uuid1_ = ((uuid1_ | (.Lape.note.align >> 12)) - (uuid1_ & (.Lape.note.align >> 12))); uuid1_ = ((uuid1_ | (.Lape.note.align << 25)) - (uuid1_ & (.Lape.note.align << 25))); uuid1_ = ((uuid1_ | (.Lape.note.align >> 27)) - (uuid1_ & (.Lape.note.align >> 27))); uuid1_ = (uuid1_ + (.Lape.note.align >> 000) & 0xFF) * 0x9e3779b9925d4c17; uuid1_ = (uuid1_ + (.Lape.note.align >> 010) & 0xFF) * 0x9e3779b9925d4c17; uuid1_ = (uuid1_ + (.Lape.note.align >> 020) & 0xFF) * 0x9e3779b9925d4c17; uuid1_ = (uuid1_ + (.Lape.note.align >> 030) & 0xFF) * 0x9e3779b9925d4c17; uuid2_ = ((uuid2_ | (.Lape.note.align >> 12)) - (uuid2_ & (.Lape.note.align >> 12))); uuid2_ = ((uuid2_ | (.Lape.note.align << 25)) - (uuid2_ & (.Lape.note.align << 25))); uuid2_ = ((uuid2_ | (.Lape.note.align >> 27)) - (uuid2_ & (.Lape.note.align >> 27))); uuid2_ = (uuid2_ + (.Lape.note.align >> 000) & 0xFF) * 0x9e3779b9925d4c17; uuid2_ = (uuid2_ + (.Lape.note.align >> 010) & 0xFF) * 0x9e3779b9925d4c17; uuid2_ = (uuid2_ + (.Lape.note.align >> 020) & 0xFF) * 0x9e3779b9925d4c17; uuid2_ = (uuid2_ + (.Lape.note.align >> 030) & 0xFF) * 0x9e3779b9925d4c17;
uuid1_ = ((uuid1_ | (.Lape.note.end >> 12)) - (uuid1_ & (.Lape.note.end >> 12))); uuid1_ = ((uuid1_ | (.Lape.note.end << 25)) - (uuid1_ & (.Lape.note.end << 25))); uuid1_ = ((uuid1_ | (.Lape.note.end >> 27)) - (uuid1_ & (.Lape.note.end >> 27))); uuid1_ = (uuid1_ + (.Lape.note.end >> 000) & 0xFF) * 0x9e3779b9925d4c17; uuid1_ = (uuid1_ + (.Lape.note.end >> 010) & 0xFF) * 0x9e3779b9925d4c17; uuid1_ = (uuid1_ + (.Lape.note.end >> 020) & 0xFF) * 0x9e3779b9925d4c17; uuid1_ = (uuid1_ + (.Lape.note.end >> 030) & 0xFF) * 0x9e3779b9925d4c17; uuid2_ = ((uuid2_ | (.Lape.note.end >> 12)) - (uuid2_ & (.Lape.note.end >> 12))); uuid2_ = ((uuid2_ | (.Lape.note.end << 25)) - (uuid2_ & (.Lape.note.end << 25))); uuid2_ = ((uuid2_ | (.Lape.note.end >> 27)) - (uuid2_ & (.Lape.note.end >> 27))); uuid2_ = (uuid2_ + (.Lape.note.end >> 000) & 0xFF) * 0x9e3779b9925d4c17; uuid2_ = (uuid2_ + (.Lape.note.end >> 010) & 0xFF) * 0x9e3779b9925d4c17; uuid2_ = (uuid2_ + (.Lape.note.end >> 020) & 0xFF) * 0x9e3779b9925d4c17; uuid2_ = (uuid2_ + (.Lape.note.end >> 030) & 0xFF) * 0x9e3779b9925d4c17;
uuid1_ = ((uuid1_ | (.Lape.note.filesz >> 12)) - (uuid1_ & (.Lape.note.filesz >> 12))); uuid1_ = ((uuid1_ | (.Lape.note.filesz << 25)) - (uuid1_ & (.Lape.note.filesz << 25))); uuid1_ = ((uuid1_ | (.Lape.note.filesz >> 27)) - (uuid1_ & (.Lape.note.filesz >> 27))); uuid1_ = (uuid1_ + (.Lape.note.filesz >> 000) & 0xFF) * 0x9e3779b9925d4c17; uuid1_ = (uuid1_ + (.Lape.note.filesz >> 010) & 0xFF) * 0x9e3779b9925d4c17; uuid1_ = (uuid1_ + (.Lape.note.filesz >> 020) & 0xFF) * 0x9e3779b9925d4c17; uuid1_ = (uuid1_ + (.Lape.note.filesz >> 030) & 0xFF) * 0x9e3779b9925d4c17; uuid2_ = ((uuid2_ | (.Lape.note.filesz >> 12)) - (uuid2_ & (.Lape.note.filesz >> 12))); uuid2_ = ((uuid2_ | (.Lape.note.filesz << 25)) - (uuid2_ & (.Lape.note.filesz << 25))); uuid2_ = ((uuid2_ | (.Lape.note.filesz >> 27)) - (uuid2_ & (.Lape.note.filesz >> 27))); uuid2_ = (uuid2_ + (.Lape.note.filesz >> 000) & 0xFF) * 0x9e3779b9925d4c17; uuid2_ = (uuid2_ + (.Lape.note.filesz >> 010) & 0xFF) * 0x9e3779b9925d4c17; uuid2_ = (uuid2_ + (.Lape.note.filesz >> 020) & 0xFF) * 0x9e3779b9925d4c17; uuid2_ = (uuid2_ + (.Lape.note.filesz >> 030) & 0xFF) * 0x9e3779b9925d4c17;
uuid1_ = ((uuid1_ | (.Lape.note.memsz >> 12)) - (uuid1_ & (.Lape.note.memsz >> 12))); uuid1_ = ((uuid1_ | (.Lape.note.memsz << 25)) - (uuid1_ & (.Lape.note.memsz << 25))); uuid1_ = ((uuid1_ | (.Lape.note.memsz >> 27)) - (uuid1_ & (.Lape.note.memsz >> 27))); uuid1_ = (uuid1_ + (.Lape.note.memsz >> 000) & 0xFF) * 0x9e3779b9925d4c17; uuid1_ = (uuid1_ + (.Lape.note.memsz >> 010) & 0xFF) * 0x9e3779b9925d4c17; uuid1_ = (uuid1_ + (.Lape.note.memsz >> 020) & 0xFF) * 0x9e3779b9925d4c17; uuid1_ = (uuid1_ + (.Lape.note.memsz >> 030) & 0xFF) * 0x9e3779b9925d4c17; uuid2_ = ((uuid2_ | (.Lape.note.memsz >> 12)) - (uuid2_ & (.Lape.note.memsz >> 12))); uuid2_ = ((uuid2_ | (.Lape.note.memsz << 25)) - (uuid2_ & (.Lape.note.memsz << 25))); uuid2_ = ((uuid2_ | (.Lape.note.memsz >> 27)) - (uuid2_ & (.Lape.note.memsz >> 27))); uuid2_ = (uuid2_ + (.Lape.note.memsz >> 000) & 0xFF) * 0x9e3779b9925d4c17; uuid2_ = (uuid2_ + (.Lape.note.memsz >> 010) & 0xFF) * 0x9e3779b9925d4c17; uuid2_ = (uuid2_ + (.Lape.note.memsz >> 020) & 0xFF) * 0x9e3779b9925d4c17; uuid2_ = (uuid2_ + (.Lape.note.memsz >> 030) & 0xFF) * 0x9e3779b9925d4c17;
uuid1_ = ((uuid1_ | (.Lape.note.offset >> 12)) - (uuid1_ & (.Lape.note.offset >> 12))); uuid1_ = ((uuid1_ | (.Lape.note.offset << 25)) - (uuid1_ & (.Lape.note.offset << 25))); uuid1_ = ((uuid1_ | (.Lape.note.offset >> 27)) - (uuid1_ & (.Lape.note.offset >> 27))); uuid1_ = (uuid1_ + (.Lape.note.offset >> 000) & 0xFF) * 0x9e3779b9925d4c17; uuid1_ = (uuid1_ + (.Lape.note.offset >> 010) & 0xFF) * 0x9e3779b9925d4c17; uuid1_ = (uuid1_ + (.Lape.note.offset >> 020) & 0xFF) * 0x9e3779b9925d4c17; uuid1_ = (uuid1_ + (.Lape.note.offset >> 030) & 0xFF) * 0x9e3779b9925d4c17; uuid2_ = ((uuid2_ | (.Lape.note.offset >> 12)) - (uuid2_ & (.Lape.note.offset >> 12))); uuid2_ = ((uuid2_ | (.Lape.note.offset << 25)) - (uuid2_ & (.Lape.note.offset << 25))); uuid2_ = ((uuid2_ | (.Lape.note.offset >> 27)) - (uuid2_ & (.Lape.note.offset >> 27))); uuid2_ = (uuid2_ + (.Lape.note.offset >> 000) & 0xFF) * 0x9e3779b9925d4c17; uuid2_ = (uuid2_ + (.Lape.note.offset >> 010) & 0xFF) * 0x9e3779b9925d4c17; uuid2_ = (uuid2_ + (.Lape.note.offset >> 020) & 0xFF) * 0x9e3779b9925d4c17; uuid2_ = (uuid2_ + (.Lape.note.offset >> 030) & 0xFF) * 0x9e3779b9925d4c17;
uuid1_ = ((uuid1_ | (.Lape.note.paddr >> 12)) - (uuid1_ & (.Lape.note.paddr >> 12))); uuid1_ = ((uuid1_ | (.Lape.note.paddr << 25)) - (uuid1_ & (.Lape.note.paddr << 25))); uuid1_ = ((uuid1_ | (.Lape.note.paddr >> 27)) - (uuid1_ & (.Lape.note.paddr >> 27))); uuid1_ = (uuid1_ + (.Lape.note.paddr >> 000) & 0xFF) * 0x9e3779b9925d4c17; uuid1_ = (uuid1_ + (.Lape.note.paddr >> 010) & 0xFF) * 0x9e3779b9925d4c17; uuid1_ = (uuid1_ + (.Lape.note.paddr >> 020) & 0xFF) * 0x9e3779b9925d4c17; uuid1_ = (uuid1_ + (.Lape.note.paddr >> 030) & 0xFF) * 0x9e3779b9925d4c17; uuid2_ = ((uuid2_ | (.Lape.note.paddr >> 12)) - (uuid2_ & (.Lape.note.paddr >> 12))); uuid2_ = ((uuid2_ | (.Lape.note.paddr << 25)) - (uuid2_ & (.Lape.note.paddr << 25))); uuid2_ = ((uuid2_ | (.Lape.note.paddr >> 27)) - (uuid2_ & (.Lape.note.paddr >> 27))); uuid2_ = (uuid2_ + (.Lape.note.paddr >> 000) & 0xFF) * 0x9e3779b9925d4c17; uuid2_ = (uuid2_ + (.Lape.note.paddr >> 010) & 0xFF) * 0x9e3779b9925d4c17; uuid2_ = (uuid2_ + (.Lape.note.paddr >> 020) & 0xFF) * 0x9e3779b9925d4c17; uuid2_ = (uuid2_ + (.Lape.note.paddr >> 030) & 0xFF) * 0x9e3779b9925d4c17;
uuid1_ = ((uuid1_ | (.Lape.note.vaddr >> 12)) - (uuid1_ & (.Lape.note.vaddr >> 12))); uuid1_ = ((uuid1_ | (.Lape.note.vaddr << 25)) - (uuid1_ & (.Lape.note.vaddr << 25))); uuid1_ = ((uuid1_ | (.Lape.note.vaddr >> 27)) - (uuid1_ & (.Lape.note.vaddr >> 27))); uuid1_ = (uuid1_ + (.Lape.note.vaddr >> 000) & 0xFF) * 0x9e3779b9925d4c17; uuid1_ = (uuid1_ + (.Lape.note.vaddr >> 010) & 0xFF) * 0x9e3779b9925d4c17; uuid1_ = (uuid1_ + (.Lape.note.vaddr >> 020) & 0xFF) * 0x9e3779b9925d4c17; uuid1_ = (uuid1_ + (.Lape.note.vaddr >> 030) & 0xFF) * 0x9e3779b9925d4c17; uuid2_ = ((uuid2_ | (.Lape.note.vaddr >> 12)) - (uuid2_ & (.Lape.note.vaddr >> 12))); uuid2_ = ((uuid2_ | (.Lape.note.vaddr << 25)) - (uuid2_ & (.Lape.note.vaddr << 25))); uuid2_ = ((uuid2_ | (.Lape.note.vaddr >> 27)) - (uuid2_ & (.Lape.note.vaddr >> 27))); uuid2_ = (uuid2_ + (.Lape.note.vaddr >> 000) & 0xFF) * 0x9e3779b9925d4c17; uuid2_ = (uuid2_ + (.Lape.note.vaddr >> 010) & 0xFF) * 0x9e3779b9925d4c17; uuid2_ = (uuid2_ + (.Lape.note.vaddr >> 020) & 0xFF) * 0x9e3779b9925d4c17; uuid2_ = (uuid2_ + (.Lape.note.vaddr >> 030) & 0xFF) * 0x9e3779b9925d4c17;
uuid1_ = ((uuid1_ | (.Lape.pe.offset >> 12)) - (uuid1_ & (.Lape.pe.offset >> 12))); uuid1_ = ((uuid1_ | (.Lape.pe.offset << 25)) - (uuid1_ & (.Lape.pe.offset << 25))); uuid1_ = ((uuid1_ | (.Lape.pe.offset >> 27)) - (uuid1_ & (.Lape.pe.offset >> 27))); uuid1_ = (uuid1_ + (.Lape.pe.offset >> 000) & 0xFF) * 0x9e3779b9925d4c17; uuid1_ = (uuid1_ + (.Lape.pe.offset >> 010) & 0xFF) * 0x9e3779b9925d4c17; uuid1_ = (uuid1_ + (.Lape.pe.offset >> 020) & 0xFF) * 0x9e3779b9925d4c17; uuid1_ = (uuid1_ + (.Lape.pe.offset >> 030) & 0xFF) * 0x9e3779b9925d4c17; uuid2_ = ((uuid2_ | (.Lape.pe.offset >> 12)) - (uuid2_ & (.Lape.pe.offset >> 12))); uuid2_ = ((uuid2_ | (.Lape.pe.offset << 25)) - (uuid2_ & (.Lape.pe.offset << 25))); uuid2_ = ((uuid2_ | (.Lape.pe.offset >> 27)) - (uuid2_ & (.Lape.pe.offset >> 27))); uuid2_ = (uuid2_ + (.Lape.pe.offset >> 000) & 0xFF) * 0x9e3779b9925d4c17; uuid2_ = (uuid2_ + (.Lape.pe.offset >> 010) & 0xFF) * 0x9e3779b9925d4c17; uuid2_ = (uuid2_ + (.Lape.pe.offset >> 020) & 0xFF) * 0x9e3779b9925d4c17; uuid2_ = (uuid2_ + (.Lape.pe.offset >> 030) & 0xFF) * 0x9e3779b9925d4c17;
uuid1_ = ((uuid1_ | (.Lape.pe.optsz >> 12)) - (uuid1_ & (.Lape.pe.optsz >> 12))); uuid1_ = ((uuid1_ | (.Lape.pe.optsz << 25)) - (uuid1_ & (.Lape.pe.optsz << 25))); uuid1_ = ((uuid1_ | (.Lape.pe.optsz >> 27)) - (uuid1_ & (.Lape.pe.optsz >> 27))); uuid1_ = (uuid1_ + (.Lape.pe.optsz >> 000) & 0xFF) * 0x9e3779b9925d4c17; uuid1_ = (uuid1_ + (.Lape.pe.optsz >> 010) & 0xFF) * 0x9e3779b9925d4c17; uuid1_ = (uuid1_ + (.Lape.pe.optsz >> 020) & 0xFF) * 0x9e3779b9925d4c17; uuid1_ = (uuid1_ + (.Lape.pe.optsz >> 030) & 0xFF) * 0x9e3779b9925d4c17; uuid2_ = ((uuid2_ | (.Lape.pe.optsz >> 12)) - (uuid2_ & (.Lape.pe.optsz >> 12))); uuid2_ = ((uuid2_ | (.Lape.pe.optsz << 25)) - (uuid2_ & (.Lape.pe.optsz << 25))); uuid2_ = ((uuid2_ | (.Lape.pe.optsz >> 27)) - (uuid2_ & (.Lape.pe.optsz >> 27))); uuid2_ = (uuid2_ + (.Lape.pe.optsz >> 000) & 0xFF) * 0x9e3779b9925d4c17; uuid2_ = (uuid2_ + (.Lape.pe.optsz >> 010) & 0xFF) * 0x9e3779b9925d4c17; uuid2_ = (uuid2_ + (.Lape.pe.optsz >> 020) & 0xFF) * 0x9e3779b9925d4c17; uuid2_ = (uuid2_ + (.Lape.pe.optsz >> 030) & 0xFF) * 0x9e3779b9925d4c17;
uuid1_ = ((uuid1_ | (.Lape.pe.sections >> 12)) - (uuid1_ & (.Lape.pe.sections >> 12))); uuid1_ = ((uuid1_ | (.Lape.pe.sections << 25)) - (uuid1_ & (.Lape.pe.sections << 25))); uuid1_ = ((uuid1_ | (.Lape.pe.sections >> 27)) - (uuid1_ & (.Lape.pe.sections >> 27))); uuid1_ = (uuid1_ + (.Lape.pe.sections >> 000) & 0xFF) * 0x9e3779b9925d4c17; uuid1_ = (uuid1_ + (.Lape.pe.sections >> 010) & 0xFF) * 0x9e3779b9925d4c17; uuid1_ = (uuid1_ + (.Lape.pe.sections >> 020) & 0xFF) * 0x9e3779b9925d4c17; uuid1_ = (uuid1_ + (.Lape.pe.sections >> 030) & 0xFF) * 0x9e3779b9925d4c17; uuid2_ = ((uuid2_ | (.Lape.pe.sections >> 12)) - (uuid2_ & (.Lape.pe.sections >> 12))); uuid2_ = ((uuid2_ | (.Lape.pe.sections << 25)) - (uuid2_ & (.Lape.pe.sections << 25))); uuid2_ = ((uuid2_ | (.Lape.pe.sections >> 27)) - (uuid2_ & (.Lape.pe.sections >> 27))); uuid2_ = (uuid2_ + (.Lape.pe.sections >> 000) & 0xFF) * 0x9e3779b9925d4c17; uuid2_ = (uuid2_ + (.Lape.pe.sections >> 010) & 0xFF) * 0x9e3779b9925d4c17; uuid2_ = (uuid2_ + (.Lape.pe.sections >> 020) & 0xFF) * 0x9e3779b9925d4c17; uuid2_ = (uuid2_ + (.Lape.pe.sections >> 030) & 0xFF) * 0x9e3779b9925d4c17;
uuid1_ = ((uuid1_ | (.Lape.pe.sections_end >> 12)) - (uuid1_ & (.Lape.pe.sections_end >> 12))); uuid1_ = ((uuid1_ | (.Lape.pe.sections_end << 25)) - (uuid1_ & (.Lape.pe.sections_end << 25))); uuid1_ = ((uuid1_ | (.Lape.pe.sections_end >> 27)) - (uuid1_ & (.Lape.pe.sections_end >> 27))); uuid1_ = (uuid1_ + (.Lape.pe.sections_end >> 000) & 0xFF) * 0x9e3779b9925d4c17; uuid1_ = (uuid1_ + (.Lape.pe.sections_end >> 010) & 0xFF) * 0x9e3779b9925d4c17; uuid1_ = (uuid1_ + (.Lape.pe.sections_end >> 020) & 0xFF) * 0x9e3779b9925d4c17; uuid1_ = (uuid1_ + (.Lape.pe.sections_end >> 030) & 0xFF) * 0x9e3779b9925d4c17; uuid2_ = ((uuid2_ | (.Lape.pe.sections_end >> 12)) - (uuid2_ & (.Lape.pe.sections_end >> 12))); uuid2_ = ((uuid2_ | (.Lape.pe.sections_end << 25)) - (uuid2_ & (.Lape.pe.sections_end << 25))); uuid2_ = ((uuid2_ | (.Lape.pe.sections_end >> 27)) - (uuid2_ & (.Lape.pe.sections_end >> 27))); uuid2_ = (uuid2_ + (.Lape.pe.sections_end >> 000) & 0xFF) * 0x9e3779b9925d4c17; uuid2_ = (uuid2_ + (.Lape.pe.sections_end >> 010) & 0xFF) * 0x9e3779b9925d4c17; uuid2_ = (uuid2_ + (.Lape.pe.sections_end >> 020) & 0xFF) * 0x9e3779b9925d4c17; uuid2_ = (uuid2_ + (.Lape.pe.sections_end >> 030) & 0xFF) * 0x9e3779b9925d4c17;
uuid1_ = ((uuid1_ | (.Lape.pe.shnum >> 12)) - (uuid1_ & (.Lape.pe.shnum >> 12))); uuid1_ = ((uuid1_ | (.Lape.pe.shnum << 25)) - (uuid1_ & (.Lape.pe.shnum << 25))); uuid1_ = ((uuid1_ | (.Lape.pe.shnum >> 27)) - (uuid1_ & (.Lape.pe.shnum >> 27))); uuid1_ = (uuid1_ + (.Lape.pe.shnum >> 000) & 0xFF) * 0x9e3779b9925d4c17; uuid1_ = (uuid1_ + (.Lape.pe.shnum >> 010) & 0xFF) * 0x9e3779b9925d4c17; uuid1_ = (uuid1_ + (.Lape.pe.shnum >> 020) & 0xFF) * 0x9e3779b9925d4c17; uuid1_ = (uuid1_ + (.Lape.pe.shnum >> 030) & 0xFF) * 0x9e3779b9925d4c17; uuid2_ = ((uuid2_ | (.Lape.pe.shnum >> 12)) - (uuid2_ & (.Lape.pe.shnum >> 12))); uuid2_ = ((uuid2_ | (.Lape.pe.shnum << 25)) - (uuid2_ & (.Lape.pe.shnum << 25))); uuid2_ = ((uuid2_ | (.Lape.pe.shnum >> 27)) - (uuid2_ & (.Lape.pe.shnum >> 27))); uuid2_ = (uuid2_ + (.Lape.pe.shnum >> 000) & 0xFF) * 0x9e3779b9925d4c17; uuid2_ = (uuid2_ + (.Lape.pe.shnum >> 010) & 0xFF) * 0x9e3779b9925d4c17; uuid2_ = (uuid2_ + (.Lape.pe.shnum >> 020) & 0xFF) * 0x9e3779b9925d4c17; uuid2_ = (uuid2_ + (.Lape.pe.shnum >> 030) & 0xFF) * 0x9e3779b9925d4c17;
uuid1_ = ((uuid1_ | (.Lape.phdrs.end >> 12)) - (uuid1_ & (.Lape.phdrs.end >> 12))); uuid1_ = ((uuid1_ | (.Lape.phdrs.end << 25)) - (uuid1_ & (.Lape.phdrs.end << 25))); uuid1_ = ((uuid1_ | (.Lape.phdrs.end >> 27)) - (uuid1_ & (.Lape.phdrs.end >> 27))); uuid1_ = (uuid1_ + (.Lape.phdrs.end >> 000) & 0xFF) * 0x9e3779b9925d4c17; uuid1_ = (uuid1_ + (.Lape.phdrs.end >> 010) & 0xFF) * 0x9e3779b9925d4c17; uuid1_ = (uuid1_ + (.Lape.phdrs.end >> 020) & 0xFF) * 0x9e3779b9925d4c17; uuid1_ = (uuid1_ + (.Lape.phdrs.end >> 030) & 0xFF) * 0x9e3779b9925d4c17; uuid2_ = ((uuid2_ | (.Lape.phdrs.end >> 12)) - (uuid2_ & (.Lape.phdrs.end >> 12))); uuid2_ = ((uuid2_ | (.Lape.phdrs.end << 25)) - (uuid2_ & (.Lape.phdrs.end << 25))); uuid2_ = ((uuid2_ | (.Lape.phdrs.end >> 27)) - (uuid2_ & (.Lape.phdrs.end >> 27))); uuid2_ = (uuid2_ + (.Lape.phdrs.end >> 000) & 0xFF) * 0x9e3779b9925d4c17; uuid2_ = (uuid2_ + (.Lape.phdrs.end >> 010) & 0xFF) * 0x9e3779b9925d4c17; uuid2_ = (uuid2_ + (.Lape.phdrs.end >> 020) & 0xFF) * 0x9e3779b9925d4c17; uuid2_ = (uuid2_ + (.Lape.phdrs.end >> 030) & 0xFF) * 0x9e3779b9925d4c17;
uuid1_ = ((uuid1_ | (.Lape.ram.align >> 12)) - (uuid1_ & (.Lape.ram.align >> 12))); uuid1_ = ((uuid1_ | (.Lape.ram.align << 25)) - (uuid1_ & (.Lape.ram.align << 25))); uuid1_ = ((uuid1_ | (.Lape.ram.align >> 27)) - (uuid1_ & (.Lape.ram.align >> 27))); uuid1_ = (uuid1_ + (.Lape.ram.align >> 000) & 0xFF) * 0x9e3779b9925d4c17; uuid1_ = (uuid1_ + (.Lape.ram.align >> 010) & 0xFF) * 0x9e3779b9925d4c17; uuid1_ = (uuid1_ + (.Lape.ram.align >> 020) & 0xFF) * 0x9e3779b9925d4c17; uuid1_ = (uuid1_ + (.Lape.ram.align >> 030) & 0xFF) * 0x9e3779b9925d4c17; uuid2_ = ((uuid2_ | (.Lape.ram.align >> 12)) - (uuid2_ & (.Lape.ram.align >> 12))); uuid2_ = ((uuid2_ | (.Lape.ram.align << 25)) - (uuid2_ & (.Lape.ram.align << 25))); uuid2_ = ((uuid2_ | (.Lape.ram.align >> 27)) - (uuid2_ & (.Lape.ram.align >> 27))); uuid2_ = (uuid2_ + (.Lape.ram.align >> 000) & 0xFF) * 0x9e3779b9925d4c17; uuid2_ = (uuid2_ + (.Lape.ram.align >> 010) & 0xFF) * 0x9e3779b9925d4c17; uuid2_ = (uuid2_ + (.Lape.ram.align >> 020) & 0xFF) * 0x9e3779b9925d4c17; uuid2_ = (uuid2_ + (.Lape.ram.align >> 030) & 0xFF) * 0x9e3779b9925d4c17;
uuid1_ = ((uuid1_ | (.Lape.ram.filesz >> 12)) - (uuid1_ & (.Lape.ram.filesz >> 12))); uuid1_ = ((uuid1_ | (.Lape.ram.filesz << 25)) - (uuid1_ & (.Lape.ram.filesz << 25))); uuid1_ = ((uuid1_ | (.Lape.ram.filesz >> 27)) - (uuid1_ & (.Lape.ram.filesz >> 27))); uuid1_ = (uuid1_ + (.Lape.ram.filesz >> 000) & 0xFF) * 0x9e3779b9925d4c17; uuid1_ = (uuid1_ + (.Lape.ram.filesz >> 010) & 0xFF) * 0x9e3779b9925d4c17; uuid1_ = (uuid1_ + (.Lape.ram.filesz >> 020) & 0xFF) * 0x9e3779b9925d4c17; uuid1_ = (uuid1_ + (.Lape.ram.filesz >> 030) & 0xFF) * 0x9e3779b9925d4c17; uuid2_ = ((uuid2_ | (.Lape.ram.filesz >> 12)) - (uuid2_ & (.Lape.ram.filesz >> 12))); uuid2_ = ((uuid2_ | (.Lape.ram.filesz << 25)) - (uuid2_ & (.Lape.ram.filesz << 25))); uuid2_ = ((uuid2_ | (.Lape.ram.filesz >> 27)) - (uuid2_ & (.Lape.ram.filesz >> 27))); uuid2_ = (uuid2_ + (.Lape.ram.filesz >> 000) & 0xFF) * 0x9e3779b9925d4c17; uuid2_ = (uuid2_ + (.Lape.ram.filesz >> 010) & 0xFF) * 0x9e3779b9925d4c17; uuid2_ = (uuid2_ + (.Lape.ram.filesz >> 020) & 0xFF) * 0x9e3779b9925d4c17; uuid2_ = (uuid2_ + (.Lape.ram.filesz >> 030) & 0xFF) * 0x9e3779b9925d4c17;
uuid1_ = ((uuid1_ | (.Lape.ram.memsz >> 12)) - (uuid1_ & (.Lape.ram.memsz >> 12))); uuid1_ = ((uuid1_ | (.Lape.ram.memsz << 25)) - (uuid1_ & (.Lape.ram.memsz << 25))); uuid1_ = ((uuid1_ | (.Lape.ram.memsz >> 27)) - (uuid1_ & (.Lape.ram.memsz >> 27))); uuid1_ = (uuid1_ + (.Lape.ram.memsz >> 000) & 0xFF) * 0x9e3779b9925d4c17; uuid1_ = (uuid1_ + (.Lape.ram.memsz >> 010) & 0xFF) * 0x9e3779b9925d4c17; uuid1_ = (uuid1_ + (.Lape.ram.memsz >> 020) & 0xFF) * 0x9e3779b9925d4c17; uuid1_ = (uuid1_ + (.Lape.ram.memsz >> 030) & 0xFF) * 0x9e3779b9925d4c17; uuid2_ = ((uuid2_ | (.Lape.ram.memsz >> 12)) - (uuid2_ & (.Lape.ram.memsz >> 12))); uuid2_ = ((uuid2_ | (.Lape.ram.memsz << 25)) - (uuid2_ & (.Lape.ram.memsz << 25))); uuid2_ = ((uuid2_ | (.Lape.ram.memsz >> 27)) - (uuid2_ & (.Lape.ram.memsz >> 27))); uuid2_ = (uuid2_ + (.Lape.ram.memsz >> 000) & 0xFF) * 0x9e3779b9925d4c17; uuid2_ = (uuid2_ + (.Lape.ram.memsz >> 010) & 0xFF) * 0x9e3779b9925d4c17; uuid2_ = (uuid2_ + (.Lape.ram.memsz >> 020) & 0xFF) * 0x9e3779b9925d4c17; uuid2_ = (uuid2_ + (.Lape.ram.memsz >> 030) & 0xFF) * 0x9e3779b9925d4c17;
uuid1_ = ((uuid1_ | (.Lape.ram.offset >> 12)) - (uuid1_ & (.Lape.ram.offset >> 12))); uuid1_ = ((uuid1_ | (.Lape.ram.offset << 25)) - (uuid1_ & (.Lape.ram.offset << 25))); uuid1_ = ((uuid1_ | (.Lape.ram.offset >> 27)) - (uuid1_ & (.Lape.ram.offset >> 27))); uuid1_ = (uuid1_ + (.Lape.ram.offset >> 000) & 0xFF) * 0x9e3779b9925d4c17; uuid1_ = (uuid1_ + (.Lape.ram.offset >> 010) & 0xFF) * 0x9e3779b9925d4c17; uuid1_ = (uuid1_ + (.Lape.ram.offset >> 020) & 0xFF) * 0x9e3779b9925d4c17; uuid1_ = (uuid1_ + (.Lape.ram.offset >> 030) & 0xFF) * 0x9e3779b9925d4c17; uuid2_ = ((uuid2_ | (.Lape.ram.offset >> 12)) - (uuid2_ & (.Lape.ram.offset >> 12))); uuid2_ = ((uuid2_ | (.Lape.ram.offset << 25)) - (uuid2_ & (.Lape.ram.offset << 25))); uuid2_ = ((uuid2_ | (.Lape.ram.offset >> 27)) - (uuid2_ & (.Lape.ram.offset >> 27))); uuid2_ = (uuid2_ + (.Lape.ram.offset >> 000) & 0xFF) * 0x9e3779b9925d4c17; uuid2_ = (uuid2_ + (.Lape.ram.offset >> 010) & 0xFF) * 0x9e3779b9925d4c17; uuid2_ = (uuid2_ + (.Lape.ram.offset >> 020) & 0xFF) * 0x9e3779b9925d4c17; uuid2_ = (uuid2_ + (.Lape.ram.offset >> 030) & 0xFF) * 0x9e3779b9925d4c17;
uuid1_ = ((uuid1_ | (.Lape.ram.paddr >> 12)) - (uuid1_ & (.Lape.ram.paddr >> 12))); uuid1_ = ((uuid1_ | (.Lape.ram.paddr << 25)) - (uuid1_ & (.Lape.ram.paddr << 25))); uuid1_ = ((uuid1_ | (.Lape.ram.paddr >> 27)) - (uuid1_ & (.Lape.ram.paddr >> 27))); uuid1_ = (uuid1_ + (.Lape.ram.paddr >> 000) & 0xFF) * 0x9e3779b9925d4c17; uuid1_ = (uuid1_ + (.Lape.ram.paddr >> 010) & 0xFF) * 0x9e3779b9925d4c17; uuid1_ = (uuid1_ + (.Lape.ram.paddr >> 020) & 0xFF) * 0x9e3779b9925d4c17; uuid1_ = (uuid1_ + (.Lape.ram.paddr >> 030) & 0xFF) * 0x9e3779b9925d4c17; uuid2_ = ((uuid2_ | (.Lape.ram.paddr >> 12)) - (uuid2_ & (.Lape.ram.paddr >> 12))); uuid2_ = ((uuid2_ | (.Lape.ram.paddr << 25)) - (uuid2_ & (.Lape.ram.paddr << 25))); uuid2_ = ((uuid2_ | (.Lape.ram.paddr >> 27)) - (uuid2_ & (.Lape.ram.paddr >> 27))); uuid2_ = (uuid2_ + (.Lape.ram.paddr >> 000) & 0xFF) * 0x9e3779b9925d4c17; uuid2_ = (uuid2_ + (.Lape.ram.paddr >> 010) & 0xFF) * 0x9e3779b9925d4c17; uuid2_ = (uuid2_ + (.Lape.ram.paddr >> 020) & 0xFF) * 0x9e3779b9925d4c17; uuid2_ = (uuid2_ + (.Lape.ram.paddr >> 030) & 0xFF) * 0x9e3779b9925d4c17;
uuid1_ = ((uuid1_ | (.Lape.ram.rva >> 12)) - (uuid1_ & (.Lape.ram.rva >> 12))); uuid1_ = ((uuid1_ | (.Lape.ram.rva << 25)) - (uuid1_ & (.Lape.ram.rva << 25))); uuid1_ = ((uuid1_ | (.Lape.ram.rva >> 27)) - (uuid1_ & (.Lape.ram.rva >> 27))); uuid1_ = (uuid1_ + (.Lape.ram.rva >> 000) & 0xFF) * 0x9e3779b9925d4c17; uuid1_ = (uuid1_ + (.Lape.ram.rva >> 010) & 0xFF) * 0x9e3779b9925d4c17; uuid1_ = (uuid1_ + (.Lape.ram.rva >> 020) & 0xFF) * 0x9e3779b9925d4c17; uuid1_ = (uuid1_ + (.Lape.ram.rva >> 030) & 0xFF) * 0x9e3779b9925d4c17; uuid2_ = ((uuid2_ | (.Lape.ram.rva >> 12)) - (uuid2_ & (.Lape.ram.rva >> 12))); uuid2_ = ((uuid2_ | (.Lape.ram.rva << 25)) - (uuid2_ & (.Lape.ram.rva << 25))); uuid2_ = ((uuid2_ | (.Lape.ram.rva >> 27)) - (uuid2_ & (.Lape.ram.rva >> 27))); uuid2_ = (uuid2_ + (.Lape.ram.rva >> 000) & 0xFF) * 0x9e3779b9925d4c17; uuid2_ = (uuid2_ + (.Lape.ram.rva >> 010) & 0xFF) * 0x9e3779b9925d4c17; uuid2_ = (uuid2_ + (.Lape.ram.rva >> 020) & 0xFF) * 0x9e3779b9925d4c17; uuid2_ = (uuid2_ + (.Lape.ram.rva >> 030) & 0xFF) * 0x9e3779b9925d4c17;
uuid1_ = ((uuid1_ | (.Lape.ram.vaddr >> 12)) - (uuid1_ & (.Lape.ram.vaddr >> 12))); uuid1_ = ((uuid1_ | (.Lape.ram.vaddr << 25)) - (uuid1_ & (.Lape.ram.vaddr << 25))); uuid1_ = ((uuid1_ | (.Lape.ram.vaddr >> 27)) - (uuid1_ & (.Lape.ram.vaddr >> 27))); uuid1_ = (uuid1_ + (.Lape.ram.vaddr >> 000) & 0xFF) * 0x9e3779b9925d4c17; uuid1_ = (uuid1_ + (.Lape.ram.vaddr >> 010) & 0xFF) * 0x9e3779b9925d4c17; uuid1_ = (uuid1_ + (.Lape.ram.vaddr >> 020) & 0xFF) * 0x9e3779b9925d4c17; uuid1_ = (uuid1_ + (.Lape.ram.vaddr >> 030) & 0xFF) * 0x9e3779b9925d4c17; uuid2_ = ((uuid2_ | (.Lape.ram.vaddr >> 12)) - (uuid2_ & (.Lape.ram.vaddr >> 12))); uuid2_ = ((uuid2_ | (.Lape.ram.vaddr << 25)) - (uuid2_ & (.Lape.ram.vaddr << 25))); uuid2_ = ((uuid2_ | (.Lape.ram.vaddr >> 27)) - (uuid2_ & (.Lape.ram.vaddr >> 27))); uuid2_ = (uuid2_ + (.Lape.ram.vaddr >> 000) & 0xFF) * 0x9e3779b9925d4c17; uuid2_ = (uuid2_ + (.Lape.ram.vaddr >> 010) & 0xFF) * 0x9e3779b9925d4c17; uuid2_ = (uuid2_ + (.Lape.ram.vaddr >> 020) & 0xFF) * 0x9e3779b9925d4c17; uuid2_ = (uuid2_ + (.Lape.ram.vaddr >> 030) & 0xFF) * 0x9e3779b9925d4c17;
uuid1_ = ((uuid1_ | (.Lape.rom.align >> 12)) - (uuid1_ & (.Lape.rom.align >> 12))); uuid1_ = ((uuid1_ | (.Lape.rom.align << 25)) - (uuid1_ & (.Lape.rom.align << 25))); uuid1_ = ((uuid1_ | (.Lape.rom.align >> 27)) - (uuid1_ & (.Lape.rom.align >> 27))); uuid1_ = (uuid1_ + (.Lape.rom.align >> 000) & 0xFF) * 0x9e3779b9925d4c17; uuid1_ = (uuid1_ + (.Lape.rom.align >> 010) & 0xFF) * 0x9e3779b9925d4c17; uuid1_ = (uuid1_ + (.Lape.rom.align >> 020) & 0xFF) * 0x9e3779b9925d4c17; uuid1_ = (uuid1_ + (.Lape.rom.align >> 030) & 0xFF) * 0x9e3779b9925d4c17; uuid2_ = ((uuid2_ | (.Lape.rom.align >> 12)) - (uuid2_ & (.Lape.rom.align >> 12))); uuid2_ = ((uuid2_ | (.Lape.rom.align << 25)) - (uuid2_ & (.Lape.rom.align << 25))); uuid2_ = ((uuid2_ | (.Lape.rom.align >> 27)) - (uuid2_ & (.Lape.rom.align >> 27))); uuid2_ = (uuid2_ + (.Lape.rom.align >> 000) & 0xFF) * 0x9e3779b9925d4c17; uuid2_ = (uuid2_ + (.Lape.rom.align >> 010) & 0xFF) * 0x9e3779b9925d4c17; uuid2_ = (uuid2_ + (.Lape.rom.align >> 020) & 0xFF) * 0x9e3779b9925d4c17; uuid2_ = (uuid2_ + (.Lape.rom.align >> 030) & 0xFF) * 0x9e3779b9925d4c17;
uuid1_ = ((uuid1_ | (.Lape.rom.filesz >> 12)) - (uuid1_ & (.Lape.rom.filesz >> 12))); uuid1_ = ((uuid1_ | (.Lape.rom.filesz << 25)) - (uuid1_ & (.Lape.rom.filesz << 25))); uuid1_ = ((uuid1_ | (.Lape.rom.filesz >> 27)) - (uuid1_ & (.Lape.rom.filesz >> 27))); uuid1_ = (uuid1_ + (.Lape.rom.filesz >> 000) & 0xFF) * 0x9e3779b9925d4c17; uuid1_ = (uuid1_ + (.Lape.rom.filesz >> 010) & 0xFF) * 0x9e3779b9925d4c17; uuid1_ = (uuid1_ + (.Lape.rom.filesz >> 020) & 0xFF) * 0x9e3779b9925d4c17; uuid1_ = (uuid1_ + (.Lape.rom.filesz >> 030) & 0xFF) * 0x9e3779b9925d4c17; uuid2_ = ((uuid2_ | (.Lape.rom.filesz >> 12)) - (uuid2_ & (.Lape.rom.filesz >> 12))); uuid2_ = ((uuid2_ | (.Lape.rom.filesz << 25)) - (uuid2_ & (.Lape.rom.filesz << 25))); uuid2_ = ((uuid2_ | (.Lape.rom.filesz >> 27)) - (uuid2_ & (.Lape.rom.filesz >> 27))); uuid2_ = (uuid2_ + (.Lape.rom.filesz >> 000) & 0xFF) * 0x9e3779b9925d4c17; uuid2_ = (uuid2_ + (.Lape.rom.filesz >> 010) & 0xFF) * 0x9e3779b9925d4c17; uuid2_ = (uuid2_ + (.Lape.rom.filesz >> 020) & 0xFF) * 0x9e3779b9925d4c17; uuid2_ = (uuid2_ + (.Lape.rom.filesz >> 030) & 0xFF) * 0x9e3779b9925d4c17;
uuid1_ = ((uuid1_ | (.Lape.rom.memsz >> 12)) - (uuid1_ & (.Lape.rom.memsz >> 12))); uuid1_ = ((uuid1_ | (.Lape.rom.memsz << 25)) - (uuid1_ & (.Lape.rom.memsz << 25))); uuid1_ = ((uuid1_ | (.Lape.rom.memsz >> 27)) - (uuid1_ & (.Lape.rom.memsz >> 27))); uuid1_ = (uuid1_ + (.Lape.rom.memsz >> 000) & 0xFF) * 0x9e3779b9925d4c17; uuid1_ = (uuid1_ + (.Lape.rom.memsz >> 010) & 0xFF) * 0x9e3779b9925d4c17; uuid1_ = (uuid1_ + (.Lape.rom.memsz >> 020) & 0xFF) * 0x9e3779b9925d4c17; uuid1_ = (uuid1_ + (.Lape.rom.memsz >> 030) & 0xFF) * 0x9e3779b9925d4c17; uuid2_ = ((uuid2_ | (.Lape.rom.memsz >> 12)) - (uuid2_ & (.Lape.rom.memsz >> 12))); uuid2_ = ((uuid2_ | (.Lape.rom.memsz << 25)) - (uuid2_ & (.Lape.rom.memsz << 25))); uuid2_ = ((uuid2_ | (.Lape.rom.memsz >> 27)) - (uuid2_ & (.Lape.rom.memsz >> 27))); uuid2_ = (uuid2_ + (.Lape.rom.memsz >> 000) & 0xFF) * 0x9e3779b9925d4c17; uuid2_ = (uuid2_ + (.Lape.rom.memsz >> 010) & 0xFF) * 0x9e3779b9925d4c17; uuid2_ = (uuid2_ + (.Lape.rom.memsz >> 020) & 0xFF) * 0x9e3779b9925d4c17; uuid2_ = (uuid2_ + (.Lape.rom.memsz >> 030) & 0xFF) * 0x9e3779b9925d4c17;
uuid1_ = ((uuid1_ | (.Lape.rom.offset >> 12)) - (uuid1_ & (.Lape.rom.offset >> 12))); uuid1_ = ((uuid1_ | (.Lape.rom.offset << 25)) - (uuid1_ & (.Lape.rom.offset << 25))); uuid1_ = ((uuid1_ | (.Lape.rom.offset >> 27)) - (uuid1_ & (.Lape.rom.offset >> 27))); uuid1_ = (uuid1_ + (.Lape.rom.offset >> 000) & 0xFF) * 0x9e3779b9925d4c17; uuid1_ = (uuid1_ + (.Lape.rom.offset >> 010) & 0xFF) * 0x9e3779b9925d4c17; uuid1_ = (uuid1_ + (.Lape.rom.offset >> 020) & 0xFF) * 0x9e3779b9925d4c17; uuid1_ = (uuid1_ + (.Lape.rom.offset >> 030) & 0xFF) * 0x9e3779b9925d4c17; uuid2_ = ((uuid2_ | (.Lape.rom.offset >> 12)) - (uuid2_ & (.Lape.rom.offset >> 12))); uuid2_ = ((uuid2_ | (.Lape.rom.offset << 25)) - (uuid2_ & (.Lape.rom.offset << 25))); uuid2_ = ((uuid2_ | (.Lape.rom.offset >> 27)) - (uuid2_ & (.Lape.rom.offset >> 27))); uuid2_ = (uuid2_ + (.Lape.rom.offset >> 000) & 0xFF) * 0x9e3779b9925d4c17; uuid2_ = (uuid2_ + (.Lape.rom.offset >> 010) & 0xFF) * 0x9e3779b9925d4c17; uuid2_ = (uuid2_ + (.Lape.rom.offset >> 020) & 0xFF) * 0x9e3779b9925d4c17; uuid2_ = (uuid2_ + (.Lape.rom.offset >> 030) & 0xFF) * 0x9e3779b9925d4c17;
uuid1_ = ((uuid1_ | (.Lape.rom.paddr >> 12)) - (uuid1_ & (.Lape.rom.paddr >> 12))); uuid1_ = ((uuid1_ | (.Lape.rom.paddr << 25)) - (uuid1_ & (.Lape.rom.paddr << 25))); uuid1_ = ((uuid1_ | (.Lape.rom.paddr >> 27)) - (uuid1_ & (.Lape.rom.paddr >> 27))); uuid1_ = (uuid1_ + (.Lape.rom.paddr >> 000) & 0xFF) * 0x9e3779b9925d4c17; uuid1_ = (uuid1_ + (.Lape.rom.paddr >> 010) & 0xFF) * 0x9e3779b9925d4c17; uuid1_ = (uuid1_ + (.Lape.rom.paddr >> 020) & 0xFF) * 0x9e3779b9925d4c17; uuid1_ = (uuid1_ + (.Lape.rom.paddr >> 030) & 0xFF) * 0x9e3779b9925d4c17; uuid2_ = ((uuid2_ | (.Lape.rom.paddr >> 12)) - (uuid2_ & (.Lape.rom.paddr >> 12))); uuid2_ = ((uuid2_ | (.Lape.rom.paddr << 25)) - (uuid2_ & (.Lape.rom.paddr << 25))); uuid2_ = ((uuid2_ | (.Lape.rom.paddr >> 27)) - (uuid2_ & (.Lape.rom.paddr >> 27))); uuid2_ = (uuid2_ + (.Lape.rom.paddr >> 000) & 0xFF) * 0x9e3779b9925d4c17; uuid2_ = (uuid2_ + (.Lape.rom.paddr >> 010) & 0xFF) * 0x9e3779b9925d4c17; uuid2_ = (uuid2_ + (.Lape.rom.paddr >> 020) & 0xFF) * 0x9e3779b9925d4c17; uuid2_ = (uuid2_ + (.Lape.rom.paddr >> 030) & 0xFF) * 0x9e3779b9925d4c17;
uuid1_ = ((uuid1_ | (.Lape.rom.rva >> 12)) - (uuid1_ & (.Lape.rom.rva >> 12))); uuid1_ = ((uuid1_ | (.Lape.rom.rva << 25)) - (uuid1_ & (.Lape.rom.rva << 25))); uuid1_ = ((uuid1_ | (.Lape.rom.rva >> 27)) - (uuid1_ & (.Lape.rom.rva >> 27))); uuid1_ = (uuid1_ + (.Lape.rom.rva >> 000) & 0xFF) * 0x9e3779b9925d4c17; uuid1_ = (uuid1_ + (.Lape.rom.rva >> 010) & 0xFF) * 0x9e3779b9925d4c17; uuid1_ = (uuid1_ + (.Lape.rom.rva >> 020) & 0xFF) * 0x9e3779b9925d4c17; uuid1_ = (uuid1_ + (.Lape.rom.rva >> 030) & 0xFF) * 0x9e3779b9925d4c17; uuid2_ = ((uuid2_ | (.Lape.rom.rva >> 12)) - (uuid2_ & (.Lape.rom.rva >> 12))); uuid2_ = ((uuid2_ | (.Lape.rom.rva << 25)) - (uuid2_ & (.Lape.rom.rva << 25))); uuid2_ = ((uuid2_ | (.Lape.rom.rva >> 27)) - (uuid2_ & (.Lape.rom.rva >> 27))); uuid2_ = (uuid2_ + (.Lape.rom.rva >> 000) & 0xFF) * 0x9e3779b9925d4c17; uuid2_ = (uuid2_ + (.Lape.rom.rva >> 010) & 0xFF) * 0x9e3779b9925d4c17; uuid2_ = (uuid2_ + (.Lape.rom.rva >> 020) & 0xFF) * 0x9e3779b9925d4c17; uuid2_ = (uuid2_ + (.Lape.rom.rva >> 030) & 0xFF) * 0x9e3779b9925d4c17;
uuid1_ = ((uuid1_ | (.Lape.rom.vaddr >> 12)) - (uuid1_ & (.Lape.rom.vaddr >> 12))); uuid1_ = ((uuid1_ | (.Lape.rom.vaddr << 25)) - (uuid1_ & (.Lape.rom.vaddr << 25))); uuid1_ = ((uuid1_ | (.Lape.rom.vaddr >> 27)) - (uuid1_ & (.Lape.rom.vaddr >> 27))); uuid1_ = (uuid1_ + (.Lape.rom.vaddr >> 000) & 0xFF) * 0x9e3779b9925d4c17; uuid1_ = (uuid1_ + (.Lape.rom.vaddr >> 010) & 0xFF) * 0x9e3779b9925d4c17; uuid1_ = (uuid1_ + (.Lape.rom.vaddr >> 020) & 0xFF) * 0x9e3779b9925d4c17; uuid1_ = (uuid1_ + (.Lape.rom.vaddr >> 030) & 0xFF) * 0x9e3779b9925d4c17; uuid2_ = ((uuid2_ | (.Lape.rom.vaddr >> 12)) - (uuid2_ & (.Lape.rom.vaddr >> 12))); uuid2_ = ((uuid2_ | (.Lape.rom.vaddr << 25)) - (uuid2_ & (.Lape.rom.vaddr << 25))); uuid2_ = ((uuid2_ | (.Lape.rom.vaddr >> 27)) - (uuid2_ & (.Lape.rom.vaddr >> 27))); uuid2_ = (uuid2_ + (.Lape.rom.vaddr >> 000) & 0xFF) * 0x9e3779b9925d4c17; uuid2_ = (uuid2_ + (.Lape.rom.vaddr >> 010) & 0xFF) * 0x9e3779b9925d4c17; uuid2_ = (uuid2_ + (.Lape.rom.vaddr >> 020) & 0xFF) * 0x9e3779b9925d4c17; uuid2_ = (uuid2_ + (.Lape.rom.vaddr >> 030) & 0xFF) * 0x9e3779b9925d4c17;
uuid1_ = ((uuid1_ | (.Lape.text.align >> 12)) - (uuid1_ & (.Lape.text.align >> 12))); uuid1_ = ((uuid1_ | (.Lape.text.align << 25)) - (uuid1_ & (.Lape.text.align << 25))); uuid1_ = ((uuid1_ | (.Lape.text.align >> 27)) - (uuid1_ & (.Lape.text.align >> 27))); uuid1_ = (uuid1_ + (.Lape.text.align >> 000) & 0xFF) * 0x9e3779b9925d4c17; uuid1_ = (uuid1_ + (.Lape.text.align >> 010) & 0xFF) * 0x9e3779b9925d4c17; uuid1_ = (uuid1_ + (.Lape.text.align >> 020) & 0xFF) * 0x9e3779b9925d4c17; uuid1_ = (uuid1_ + (.Lape.text.align >> 030) & 0xFF) * 0x9e3779b9925d4c17; uuid2_ = ((uuid2_ | (.Lape.text.align >> 12)) - (uuid2_ & (.Lape.text.align >> 12))); uuid2_ = ((uuid2_ | (.Lape.text.align << 25)) - (uuid2_ & (.Lape.text.align << 25))); uuid2_ = ((uuid2_ | (.Lape.text.align >> 27)) - (uuid2_ & (.Lape.text.align >> 27))); uuid2_ = (uuid2_ + (.Lape.text.align >> 000) & 0xFF) * 0x9e3779b9925d4c17; uuid2_ = (uuid2_ + (.Lape.text.align >> 010) & 0xFF) * 0x9e3779b9925d4c17; uuid2_ = (uuid2_ + (.Lape.text.align >> 020) & 0xFF) * 0x9e3779b9925d4c17; uuid2_ = (uuid2_ + (.Lape.text.align >> 030) & 0xFF) * 0x9e3779b9925d4c17;
uuid1_ = ((uuid1_ | (.Lape.text.filesz >> 12)) - (uuid1_ & (.Lape.text.filesz >> 12))); uuid1_ = ((uuid1_ | (.Lape.text.filesz << 25)) - (uuid1_ & (.Lape.text.filesz << 25))); uuid1_ = ((uuid1_ | (.Lape.text.filesz >> 27)) - (uuid1_ & (.Lape.text.filesz >> 27))); uuid1_ = (uuid1_ + (.Lape.text.filesz >> 000) & 0xFF) * 0x9e3779b9925d4c17; uuid1_ = (uuid1_ + (.Lape.text.filesz >> 010) & 0xFF) * 0x9e3779b9925d4c17; uuid1_ = (uuid1_ + (.Lape.text.filesz >> 020) & 0xFF) * 0x9e3779b9925d4c17; uuid1_ = (uuid1_ + (.Lape.text.filesz >> 030) & 0xFF) * 0x9e3779b9925d4c17; uuid2_ = ((uuid2_ | (.Lape.text.filesz >> 12)) - (uuid2_ & (.Lape.text.filesz >> 12))); uuid2_ = ((uuid2_ | (.Lape.text.filesz << 25)) - (uuid2_ & (.Lape.text.filesz << 25))); uuid2_ = ((uuid2_ | (.Lape.text.filesz >> 27)) - (uuid2_ & (.Lape.text.filesz >> 27))); uuid2_ = (uuid2_ + (.Lape.text.filesz >> 000) & 0xFF) * 0x9e3779b9925d4c17; uuid2_ = (uuid2_ + (.Lape.text.filesz >> 010) & 0xFF) * 0x9e3779b9925d4c17; uuid2_ = (uuid2_ + (.Lape.text.filesz >> 020) & 0xFF) * 0x9e3779b9925d4c17; uuid2_ = (uuid2_ + (.Lape.text.filesz >> 030) & 0xFF) * 0x9e3779b9925d4c17;
uuid1_ = ((uuid1_ | (.Lape.text.memsz >> 12)) - (uuid1_ & (.Lape.text.memsz >> 12))); uuid1_ = ((uuid1_ | (.Lape.text.memsz << 25)) - (uuid1_ & (.Lape.text.memsz << 25))); uuid1_ = ((uuid1_ | (.Lape.text.memsz >> 27)) - (uuid1_ & (.Lape.text.memsz >> 27))); uuid1_ = (uuid1_ + (.Lape.text.memsz >> 000) & 0xFF) * 0x9e3779b9925d4c17; uuid1_ = (uuid1_ + (.Lape.text.memsz >> 010) & 0xFF) * 0x9e3779b9925d4c17; uuid1_ = (uuid1_ + (.Lape.text.memsz >> 020) & 0xFF) * 0x9e3779b9925d4c17; uuid1_ = (uuid1_ + (.Lape.text.memsz >> 030) & 0xFF) * 0x9e3779b9925d4c17; uuid2_ = ((uuid2_ | (.Lape.text.memsz >> 12)) - (uuid2_ & (.Lape.text.memsz >> 12))); uuid2_ = ((uuid2_ | (.Lape.text.memsz << 25)) - (uuid2_ & (.Lape.text.memsz << 25))); uuid2_ = ((uuid2_ | (.Lape.text.memsz >> 27)) - (uuid2_ & (.Lape.text.memsz >> 27))); uuid2_ = (uuid2_ + (.Lape.text.memsz >> 000) & 0xFF) * 0x9e3779b9925d4c17; uuid2_ = (uuid2_ + (.Lape.text.memsz >> 010) & 0xFF) * 0x9e3779b9925d4c17; uuid2_ = (uuid2_ + (.Lape.text.memsz >> 020) & 0xFF) * 0x9e3779b9925d4c17; uuid2_ = (uuid2_ + (.Lape.text.memsz >> 030) & 0xFF) * 0x9e3779b9925d4c17;
uuid1_ = ((uuid1_ | (.Lape.text.offset >> 12)) - (uuid1_ & (.Lape.text.offset >> 12))); uuid1_ = ((uuid1_ | (.Lape.text.offset << 25)) - (uuid1_ & (.Lape.text.offset << 25))); uuid1_ = ((uuid1_ | (.Lape.text.offset >> 27)) - (uuid1_ & (.Lape.text.offset >> 27))); uuid1_ = (uuid1_ + (.Lape.text.offset >> 000) & 0xFF) * 0x9e3779b9925d4c17; uuid1_ = (uuid1_ + (.Lape.text.offset >> 010) & 0xFF) * 0x9e3779b9925d4c17; uuid1_ = (uuid1_ + (.Lape.text.offset >> 020) & 0xFF) * 0x9e3779b9925d4c17; uuid1_ = (uuid1_ + (.Lape.text.offset >> 030) & 0xFF) * 0x9e3779b9925d4c17; uuid2_ = ((uuid2_ | (.Lape.text.offset >> 12)) - (uuid2_ & (.Lape.text.offset >> 12))); uuid2_ = ((uuid2_ | (.Lape.text.offset << 25)) - (uuid2_ & (.Lape.text.offset << 25))); uuid2_ = ((uuid2_ | (.Lape.text.offset >> 27)) - (uuid2_ & (.Lape.text.offset >> 27))); uuid2_ = (uuid2_ + (.Lape.text.offset >> 000) & 0xFF) * 0x9e3779b9925d4c17; uuid2_ = (uuid2_ + (.Lape.text.offset >> 010) & 0xFF) * 0x9e3779b9925d4c17; uuid2_ = (uuid2_ + (.Lape.text.offset >> 020) & 0xFF) * 0x9e3779b9925d4c17; uuid2_ = (uuid2_ + (.Lape.text.offset >> 030) & 0xFF) * 0x9e3779b9925d4c17;
uuid1_ = ((uuid1_ | (.Lape.text.paddr >> 12)) - (uuid1_ & (.Lape.text.paddr >> 12))); uuid1_ = ((uuid1_ | (.Lape.text.paddr << 25)) - (uuid1_ & (.Lape.text.paddr << 25))); uuid1_ = ((uuid1_ | (.Lape.text.paddr >> 27)) - (uuid1_ & (.Lape.text.paddr >> 27))); uuid1_ = (uuid1_ + (.Lape.text.paddr >> 000) & 0xFF) * 0x9e3779b9925d4c17; uuid1_ = (uuid1_ + (.Lape.text.paddr >> 010) & 0xFF) * 0x9e3779b9925d4c17; uuid1_ = (uuid1_ + (.Lape.text.paddr >> 020) & 0xFF) * 0x9e3779b9925d4c17; uuid1_ = (uuid1_ + (.Lape.text.paddr >> 030) & 0xFF) * 0x9e3779b9925d4c17; uuid2_ = ((uuid2_ | (.Lape.text.paddr >> 12)) - (uuid2_ & (.Lape.text.paddr >> 12))); uuid2_ = ((uuid2_ | (.Lape.text.paddr << 25)) - (uuid2_ & (.Lape.text.paddr << 25))); uuid2_ = ((uuid2_ | (.Lape.text.paddr >> 27)) - (uuid2_ & (.Lape.text.paddr >> 27))); uuid2_ = (uuid2_ + (.Lape.text.paddr >> 000) & 0xFF) * 0x9e3779b9925d4c17; uuid2_ = (uuid2_ + (.Lape.text.paddr >> 010) & 0xFF) * 0x9e3779b9925d4c17; uuid2_ = (uuid2_ + (.Lape.text.paddr >> 020) & 0xFF) * 0x9e3779b9925d4c17; uuid2_ = (uuid2_ + (.Lape.text.paddr >> 030) & 0xFF) * 0x9e3779b9925d4c17;
uuid1_ = ((uuid1_ | (.Lape.text.rva >> 12)) - (uuid1_ & (.Lape.text.rva >> 12))); uuid1_ = ((uuid1_ | (.Lape.text.rva << 25)) - (uuid1_ & (.Lape.text.rva << 25))); uuid1_ = ((uuid1_ | (.Lape.text.rva >> 27)) - (uuid1_ & (.Lape.text.rva >> 27))); uuid1_ = (uuid1_ + (.Lape.text.rva >> 000) & 0xFF) * 0x9e3779b9925d4c17; uuid1_ = (uuid1_ + (.Lape.text.rva >> 010) & 0xFF) * 0x9e3779b9925d4c17; uuid1_ = (uuid1_ + (.Lape.text.rva >> 020) & 0xFF) * 0x9e3779b9925d4c17; uuid1_ = (uuid1_ + (.Lape.text.rva >> 030) & 0xFF) * 0x9e3779b9925d4c17; uuid2_ = ((uuid2_ | (.Lape.text.rva >> 12)) - (uuid2_ & (.Lape.text.rva >> 12))); uuid2_ = ((uuid2_ | (.Lape.text.rva << 25)) - (uuid2_ & (.Lape.text.rva << 25))); uuid2_ = ((uuid2_ | (.Lape.text.rva >> 27)) - (uuid2_ & (.Lape.text.rva >> 27))); uuid2_ = (uuid2_ + (.Lape.text.rva >> 000) & 0xFF) * 0x9e3779b9925d4c17; uuid2_ = (uuid2_ + (.Lape.text.rva >> 010) & 0xFF) * 0x9e3779b9925d4c17; uuid2_ = (uuid2_ + (.Lape.text.rva >> 020) & 0xFF) * 0x9e3779b9925d4c17; uuid2_ = (uuid2_ + (.Lape.text.rva >> 030) & 0xFF) * 0x9e3779b9925d4c17;
uuid1_ = ((uuid1_ | (.Lape.text.vaddr >> 12)) - (uuid1_ & (.Lape.text.vaddr >> 12))); uuid1_ = ((uuid1_ | (.Lape.text.vaddr << 25)) - (uuid1_ & (.Lape.text.vaddr << 25))); uuid1_ = ((uuid1_ | (.Lape.text.vaddr >> 27)) - (uuid1_ & (.Lape.text.vaddr >> 27))); uuid1_ = (uuid1_ + (.Lape.text.vaddr >> 000) & 0xFF) * 0x9e3779b9925d4c17; uuid1_ = (uuid1_ + (.Lape.text.vaddr >> 010) & 0xFF) * 0x9e3779b9925d4c17; uuid1_ = (uuid1_ + (.Lape.text.vaddr >> 020) & 0xFF) * 0x9e3779b9925d4c17; uuid1_ = (uuid1_ + (.Lape.text.vaddr >> 030) & 0xFF) * 0x9e3779b9925d4c17; uuid2_ = ((uuid2_ | (.Lape.text.vaddr >> 12)) - (uuid2_ & (.Lape.text.vaddr >> 12))); uuid2_ = ((uuid2_ | (.Lape.text.vaddr << 25)) - (uuid2_ & (.Lape.text.vaddr << 25))); uuid2_ = ((uuid2_ | (.Lape.text.vaddr >> 27)) - (uuid2_ & (.Lape.text.vaddr >> 27))); uuid2_ = (uuid2_ + (.Lape.text.vaddr >> 000) & 0xFF) * 0x9e3779b9925d4c17; uuid2_ = (uuid2_ + (.Lape.text.vaddr >> 010) & 0xFF) * 0x9e3779b9925d4c17; uuid2_ = (uuid2_ + (.Lape.text.vaddr >> 020) & 0xFF) * 0x9e3779b9925d4c17; uuid2_ = (uuid2_ + (.Lape.text.vaddr >> 030) & 0xFF) * 0x9e3779b9925d4c17;
uuid1_ = ((uuid1_ | (ADDR(.bss) >> 12)) - (uuid1_ & (ADDR(.bss) >> 12))); uuid1_ = ((uuid1_ | (ADDR(.bss) << 25)) - (uuid1_ & (ADDR(.bss) << 25))); uuid1_ = ((uuid1_ | (ADDR(.bss) >> 27)) - (uuid1_ & (ADDR(.bss) >> 27))); uuid1_ = (uuid1_ + (ADDR(.bss) >> 000) & 0xFF) * 0x9e3779b9925d4c17; uuid1_ = (uuid1_ + (ADDR(.bss) >> 010) & 0xFF) * 0x9e3779b9925d4c17; uuid1_ = (uuid1_ + (ADDR(.bss) >> 020) & 0xFF) * 0x9e3779b9925d4c17; uuid1_ = (uuid1_ + (ADDR(.bss) >> 030) & 0xFF) * 0x9e3779b9925d4c17; uuid2_ = ((uuid2_ | (ADDR(.bss) >> 12)) - (uuid2_ & (ADDR(.bss) >> 12))); uuid2_ = ((uuid2_ | (ADDR(.bss) << 25)) - (uuid2_ & (ADDR(.bss) << 25))); uuid2_ = ((uuid2_ | (ADDR(.bss) >> 27)) - (uuid2_ & (ADDR(.bss) >> 27))); uuid2_ = (uuid2_ + (ADDR(.bss) >> 000) & 0xFF) * 0x9e3779b9925d4c17; uuid2_ = (uuid2_ + (ADDR(.bss) >> 010) & 0xFF) * 0x9e3779b9925d4c17; uuid2_ = (uuid2_ + (ADDR(.bss) >> 020) & 0xFF) * 0x9e3779b9925d4c17; uuid2_ = (uuid2_ + (ADDR(.bss) >> 030) & 0xFF) * 0x9e3779b9925d4c17;
uuid1_ = ((uuid1_ | (WinMain >> 12)) - (uuid1_ & (WinMain >> 12))); uuid1_ = ((uuid1_ | (WinMain << 25)) - (uuid1_ & (WinMain << 25))); uuid1_ = ((uuid1_ | (WinMain >> 27)) - (uuid1_ & (WinMain >> 27))); uuid1_ = (uuid1_ + (WinMain >> 000) & 0xFF) * 0x9e3779b9925d4c17; uuid1_ = (uuid1_ + (WinMain >> 010) & 0xFF) * 0x9e3779b9925d4c17; uuid1_ = (uuid1_ + (WinMain >> 020) & 0xFF) * 0x9e3779b9925d4c17; uuid1_ = (uuid1_ + (WinMain >> 030) & 0xFF) * 0x9e3779b9925d4c17; uuid2_ = ((uuid2_ | (WinMain >> 12)) - (uuid2_ & (WinMain >> 12))); uuid2_ = ((uuid2_ | (WinMain << 25)) - (uuid2_ & (WinMain << 25))); uuid2_ = ((uuid2_ | (WinMain >> 27)) - (uuid2_ & (WinMain >> 27))); uuid2_ = (uuid2_ + (WinMain >> 000) & 0xFF) * 0x9e3779b9925d4c17; uuid2_ = (uuid2_ + (WinMain >> 010) & 0xFF) * 0x9e3779b9925d4c17; uuid2_ = (uuid2_ + (WinMain >> 020) & 0xFF) * 0x9e3779b9925d4c17; uuid2_ = (uuid2_ + (WinMain >> 030) & 0xFF) * 0x9e3779b9925d4c17;
uuid1_ = ((uuid1_ | (_start >> 12)) - (uuid1_ & (_start >> 12))); uuid1_ = ((uuid1_ | (_start << 25)) - (uuid1_ & (_start << 25))); uuid1_ = ((uuid1_ | (_start >> 27)) - (uuid1_ & (_start >> 27))); uuid1_ = (uuid1_ + (_start >> 000) & 0xFF) * 0x9e3779b9925d4c17; uuid1_ = (uuid1_ + (_start >> 010) & 0xFF) * 0x9e3779b9925d4c17; uuid1_ = (uuid1_ + (_start >> 020) & 0xFF) * 0x9e3779b9925d4c17; uuid1_ = (uuid1_ + (_start >> 030) & 0xFF) * 0x9e3779b9925d4c17; uuid2_ = ((uuid2_ | (_start >> 12)) - (uuid2_ & (_start >> 12))); uuid2_ = ((uuid2_ | (_start << 25)) - (uuid2_ & (_start << 25))); uuid2_ = ((uuid2_ | (_start >> 27)) - (uuid2_ & (_start >> 27))); uuid2_ = (uuid2_ + (_start >> 000) & 0xFF) * 0x9e3779b9925d4c17; uuid2_ = (uuid2_ + (_start >> 010) & 0xFF) * 0x9e3779b9925d4c17; uuid2_ = (uuid2_ + (_start >> 020) & 0xFF) * 0x9e3779b9925d4c17; uuid2_ = (uuid2_ + (_start >> 030) & 0xFF) * 0x9e3779b9925d4c17;
uuid1_ = ((uuid1_ | (ape.macho >> 12)) - (uuid1_ & (ape.macho >> 12))); uuid1_ = ((uuid1_ | (ape.macho << 25)) - (uuid1_ & (ape.macho << 25))); uuid1_ = ((uuid1_ | (ape.macho >> 27)) - (uuid1_ & (ape.macho >> 27))); uuid1_ = (uuid1_ + (ape.macho >> 000) & 0xFF) * 0x9e3779b9925d4c17; uuid1_ = (uuid1_ + (ape.macho >> 010) & 0xFF) * 0x9e3779b9925d4c17; uuid1_ = (uuid1_ + (ape.macho >> 020) & 0xFF) * 0x9e3779b9925d4c17; uuid1_ = (uuid1_ + (ape.macho >> 030) & 0xFF) * 0x9e3779b9925d4c17; uuid2_ = ((uuid2_ | (ape.macho >> 12)) - (uuid2_ & (ape.macho >> 12))); uuid2_ = ((uuid2_ | (ape.macho << 25)) - (uuid2_ & (ape.macho << 25))); uuid2_ = ((uuid2_ | (ape.macho >> 27)) - (uuid2_ & (ape.macho >> 27))); uuid2_ = (uuid2_ + (ape.macho >> 000) & 0xFF) * 0x9e3779b9925d4c17; uuid2_ = (uuid2_ + (ape.macho >> 010) & 0xFF) * 0x9e3779b9925d4c17; uuid2_ = (uuid2_ + (ape.macho >> 020) & 0xFF) * 0x9e3779b9925d4c17; uuid2_ = (uuid2_ + (ape.macho >> 030) & 0xFF) * 0x9e3779b9925d4c17;
uuid1_ = ((uuid1_ | (ape.mz >> 12)) - (uuid1_ & (ape.mz >> 12))); uuid1_ = ((uuid1_ | (ape.mz << 25)) - (uuid1_ & (ape.mz << 25))); uuid1_ = ((uuid1_ | (ape.mz >> 27)) - (uuid1_ & (ape.mz >> 27))); uuid1_ = (uuid1_ + (ape.mz >> 000) & 0xFF) * 0x9e3779b9925d4c17; uuid1_ = (uuid1_ + (ape.mz >> 010) & 0xFF) * 0x9e3779b9925d4c17; uuid1_ = (uuid1_ + (ape.mz >> 020) & 0xFF) * 0x9e3779b9925d4c17; uuid1_ = (uuid1_ + (ape.mz >> 030) & 0xFF) * 0x9e3779b9925d4c17; uuid2_ = ((uuid2_ | (ape.mz >> 12)) - (uuid2_ & (ape.mz >> 12))); uuid2_ = ((uuid2_ | (ape.mz << 25)) - (uuid2_ & (ape.mz << 25))); uuid2_ = ((uuid2_ | (ape.mz >> 27)) - (uuid2_ & (ape.mz >> 27))); uuid2_ = (uuid2_ + (ape.mz >> 000) & 0xFF) * 0x9e3779b9925d4c17; uuid2_ = (uuid2_ + (ape.mz >> 010) & 0xFF) * 0x9e3779b9925d4c17; uuid2_ = (uuid2_ + (ape.mz >> 020) & 0xFF) * 0x9e3779b9925d4c17; uuid2_ = (uuid2_ + (ape.mz >> 030) & 0xFF) * 0x9e3779b9925d4c17;
uuid1_ = ((uuid1_ | (ape.pe >> 12)) - (uuid1_ & (ape.pe >> 12))); uuid1_ = ((uuid1_ | (ape.pe << 25)) - (uuid1_ & (ape.pe << 25))); uuid1_ = ((uuid1_ | (ape.pe >> 27)) - (uuid1_ & (ape.pe >> 27))); uuid1_ = (uuid1_ + (ape.pe >> 000) & 0xFF) * 0x9e3779b9925d4c17; uuid1_ = (uuid1_ + (ape.pe >> 010) & 0xFF) * 0x9e3779b9925d4c17; uuid1_ = (uuid1_ + (ape.pe >> 020) & 0xFF) * 0x9e3779b9925d4c17; uuid1_ = (uuid1_ + (ape.pe >> 030) & 0xFF) * 0x9e3779b9925d4c17; uuid2_ = ((uuid2_ | (ape.pe >> 12)) - (uuid2_ & (ape.pe >> 12))); uuid2_ = ((uuid2_ | (ape.pe << 25)) - (uuid2_ & (ape.pe << 25))); uuid2_ = ((uuid2_ | (ape.pe >> 27)) - (uuid2_ & (ape.pe >> 27))); uuid2_ = (uuid2_ + (ape.pe >> 000) & 0xFF) * 0x9e3779b9925d4c17; uuid2_ = (uuid2_ + (ape.pe >> 010) & 0xFF) * 0x9e3779b9925d4c17; uuid2_ = (uuid2_ + (ape.pe >> 020) & 0xFF) * 0x9e3779b9925d4c17; uuid2_ = (uuid2_ + (ape.pe >> 030) & 0xFF) * 0x9e3779b9925d4c17;
uuid1_ = ((uuid1_ | (ape.phdrs >> 12)) - (uuid1_ & (ape.phdrs >> 12))); uuid1_ = ((uuid1_ | (ape.phdrs << 25)) - (uuid1_ & (ape.phdrs << 25))); uuid1_ = ((uuid1_ | (ape.phdrs >> 27)) - (uuid1_ & (ape.phdrs >> 27))); uuid1_ = (uuid1_ + (ape.phdrs >> 000) & 0xFF) * 0x9e3779b9925d4c17; uuid1_ = (uuid1_ + (ape.phdrs >> 010) & 0xFF) * 0x9e3779b9925d4c17; uuid1_ = (uuid1_ + (ape.phdrs >> 020) & 0xFF) * 0x9e3779b9925d4c17; uuid1_ = (uuid1_ + (ape.phdrs >> 030) & 0xFF) * 0x9e3779b9925d4c17; uuid2_ = ((uuid2_ | (ape.phdrs >> 12)) - (uuid2_ & (ape.phdrs >> 12))); uuid2_ = ((uuid2_ | (ape.phdrs << 25)) - (uuid2_ & (ape.phdrs << 25))); uuid2_ = ((uuid2_ | (ape.phdrs >> 27)) - (uuid2_ & (ape.phdrs >> 27))); uuid2_ = (uuid2_ + (ape.phdrs >> 000) & 0xFF) * 0x9e3779b9925d4c17; uuid2_ = (uuid2_ + (ape.phdrs >> 010) & 0xFF) * 0x9e3779b9925d4c17; uuid2_ = (uuid2_ + (ape.phdrs >> 020) & 0xFF) * 0x9e3779b9925d4c17; uuid2_ = (uuid2_ + (ape.phdrs >> 030) & 0xFF) * 0x9e3779b9925d4c17;
uuid1_ = ((uuid1_ | (v_ape_realsectors >> 12)) - (uuid1_ & (v_ape_realsectors >> 12))); uuid1_ = ((uuid1_ | (v_ape_realsectors << 25)) - (uuid1_ & (v_ape_realsectors << 25))); uuid1_ = ((uuid1_ | (v_ape_realsectors >> 27)) - (uuid1_ & (v_ape_realsectors >> 27))); uuid1_ = (uuid1_ + (v_ape_realsectors >> 000) & 0xFF) * 0x9e3779b9925d4c17; uuid1_ = (uuid1_ + (v_ape_realsectors >> 010) & 0xFF) * 0x9e3779b9925d4c17; uuid1_ = (uuid1_ + (v_ape_realsectors >> 020) & 0xFF) * 0x9e3779b9925d4c17; uuid1_ = (uuid1_ + (v_ape_realsectors >> 030) & 0xFF) * 0x9e3779b9925d4c17; uuid2_ = ((uuid2_ | (v_ape_realsectors >> 12)) - (uuid2_ & (v_ape_realsectors >> 12))); uuid2_ = ((uuid2_ | (v_ape_realsectors << 25)) - (uuid2_ & (v_ape_realsectors << 25))); uuid2_ = ((uuid2_ | (v_ape_realsectors >> 27)) - (uuid2_ & (v_ape_realsectors >> 27))); uuid2_ = (uuid2_ + (v_ape_realsectors >> 000) & 0xFF) * 0x9e3779b9925d4c17; uuid2_ = (uuid2_ + (v_ape_realsectors >> 010) & 0xFF) * 0x9e3779b9925d4c17; uuid2_ = (uuid2_ + (v_ape_realsectors >> 020) & 0xFF) * 0x9e3779b9925d4c17; uuid2_ = (uuid2_ + (v_ape_realsectors >> 030) & 0xFF) * 0x9e3779b9925d4c17;
ASSERT(ape.mz == 0x400000, "linker panic");
ASSERT((DEFINED(__init_bss_end) ? __init_bss_end : 0) % 8 == 0,
       "__init_bss misalign");
ASSERT(((DEFINED(__init_rodata_end) ? __init_rodata_end : 0) %
        8 == 0),
       "__init_rodata misalign");
ASSERT((!DEFINED(ape.grub) ? 1 : ((ape.grub) - (0x400000)) < 8192),
       "grub stub needs to be in first 8kb of image");
ASSERT(DEFINED(_start) || DEFINED(_start16),
       "please link a _start() or _start16() entrypoint");
ASSERT(!DEFINED(_start16) || ((_end) - (0x400000 - (0x1000 + (((0x2240 + 8) + (0x1000)-1) & -(0x1000))))) < 65536,
       "ape won't support non-tiny real mode programs");
